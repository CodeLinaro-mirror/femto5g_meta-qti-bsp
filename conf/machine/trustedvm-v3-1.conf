## meta-qti-base/conf/machine/gvm-gen5.conf
```bitbake
#@TYPE: Machine
#@NAME: gvm-gen5
#@DESCRIPTION: Machine configuration for QTI SH GVM NORD(GEN5) Platform

BASEMACHINE ?= "gvm-gen5"
include conf/machine/include/auto-common.inc

#MASK unused recipe in target
include conf/machine/include/gvm-bbmask.inc
include conf/distro/include/gvm-bbmask-prop.inc

include conf/machine/include/tune-cortexa78c.inc

PREFERRED_PROVIDER_dtc-native = "dtc-aosp-native"

PREFERRED_VERSION_linux-msm = "6.12"

# Keep above PREFERRED_VERSION_linux-msm for it's involved in many receipes.
# Switch to linux-ack (GKI kernel compiled with clang) as
# virtual/kernel provider for gvm-gen5, mirroring the Bazel DDK build flow.
PREFERRED_PROVIDER_virtual/kernel = "linux-ack"
PREFERRED_PROVIDER_virtual/kernel-headers = "linux-ack-headers"
PREFERRED_VERSION_linux-ack = "6.12"
PREFERRED_VERSION_linux-ack-headers = "6.12"
preferred-kernel = "PREFERRED_VERSION_linux-ack"

PREFERRED_VERSION_media-codec2 = "auto.1.0"
PREFERRED_VERSION_media-external = "auto.1.0"
PREFERRED_VERSION_media-noship = "auto.1.0"
PREFERRED_VERSION_codec2-service = "auto.1.0"
PREFERRED_VERSION_adreno = "0.1"

# gvm prefer camx
PREFERRED_VERSION_cameradlkm = "0.2"

KERNEL_ARCH = "autogvm"
KERNEL_VARIANT = "${@bb.utils.contains_any('VARIANT', 'perf user', 'perf_', 'debug_', d)}"
KERNEL_DEFCONFIG_VARIANT = "${@bb.utils.contains_any('VARIANT', 'perf user', 'defconfig', 'debug-defconfig', d)}"
KERNEL_OUT_VARIANT = "${@bb.utils.contains_any('VARIANT', 'perf user', '', 'debug_', d)}"
KERNEL_BUILD_CONFIG = "soc-repo/build.config.msm.${KERNEL_ARCH}.lv"
KERNEL_IMAGE_HEADER_VERSION = "2"

KERNEL_BASE = "0x80000000"
KERNEL_TAGS_OFFSET = "0x1e00000"
KERNEL_CONFIG = "${@['vendor/autogvm_defconfig', 'vendor/autogvm-debug_defconfig'][d.getVar('VARIANT', True) == ('' or 'debug')]}"
KERNEL_CMD_PARAMS = " "
KERNEL_IMAGETYPE = "Image"

MACHINE_FEATURES += "\
    qti-security \
    qti-core \
    qti-hypervisor \
    qti-gvm \
    dt-overlay \
    qti-dlkm \
    early-ramdisk-init \
    qti-data \
    qti-audio-awe \
    qti-adsp \
    qti-cdsp \
    qti-cdsp1 \
    qti-extra \
    qti-display \
    qti-graphics \
    qti-camera \
    qti-multimedia \
"

KERNEL_CMD_PARAMS:append = "${@bb.utils.contains('MACHINE_FEATURES', 'early-ramdisk-init', ' rdinit=/sbin/early-ramdisk-init early-ramdisk.mode=3 ', '', d)}"
KERNEL_CMD_PARAMS:append = " ro "

EARLY_RAMDISK_KERNEL_MODULES = "\
    kernel-module-virtio-mmio-${KERNEL_VERSION} \
    kernel-module-failover-${KERNEL_VERSION} \
    kernel-module-net-failover-${KERNEL_VERSION} \
    kernel-module-virtio-net-${KERNEL_VERSION} \
    kernel-module-msm-hab-${KERNEL_VERSION} \
    kernel-module-crypto-qti-virt-${KERNEL_VERSION} \
    kernel-module-virtio-block-${KERNEL_VERSION} \
    kernel-module-virtio-blk-qti-crypto-${KERNEL_VERSION} \
    kernel-module-gh-dbl-${KERNEL_VERSION} \
    kernel-module-gh-msgq-${KERNEL_VERSION} \
    kernel-module-gh-arm-drv-${KERNEL_VERSION} \
    kernel-module-gh-rm-drv-${KERNEL_VERSION} \
    kernel-module-socinfo-dt-${KERNEL_VERSION} \
"

SECTOOLS_VERSION = "sectools-v2"
SECTOOLS_SECURITY_PROFILE = "nord_security_profile.xml"
```

## meta-qti-base/conf/machine/include/gvm-bbmask.inc
```bitbake
# BBMASK drops some recipe that checksum file not found
BBMASK:append = " ${MISSING_RECIPE_SRCLIST}"
MISSING_RECIPE_SRCLIST:append:quin-gvm-gen4 = " ${MISSING_RECIPE_SRCLIST_BASELINE_LV050}"
MISSING_RECIPE_SRCLIST:append:qtiquingvm8295 = " ${MISSING_RECIPE_SRCLIST_BASELINE_LV050}"
MISSING_RECIPE_SRCLIST:append:quin-gvm-gen4-5 = " ${MISSING_RECIPE_SRCLIST_BASELINE_LV051}"
MISSING_RECIPE_SRCLIST:append:gvm-gen4-5 = " ${MISSING_RECIPE_SRCLIST_BASELINE_LV051}"
MISSING_RECIPE_SRCLIST:append:gvm-gen5 = " ${MISSING_RECIPE_SRCLIST_BASELINE_LV052}"

# unsed bbappend
BBMASK:append = " \
meta-qti-bsp/meta-qti-extra/recipes-devtools/gtest/googletest_git.bbappend \
meta-qti-bsp/meta-qti-base/recipes-multimedia/ffmpeg/ffmpeg_5.0.%.bbappend \
meta-qti-bsp/meta-qti-base/recipes-graphics/wayland/weston_10.0.%.bbappend \
"

# Missing recipes globally
MISSING_RECIPE_SRCLIST += "\
meta-qti-bsp/meta-qti-base/recipes-bsp/abctl/abctl_1.0.bb \
meta-qti-bsp/meta-qti-base/recipes-bsp/libgpt/libgpt_1.0.bb \
meta-qti-bsp/meta-qti-extra/recipes-test/virt-spmi-ut/virt-spmi-ut.bb \
meta-qti-bsp/meta-qti-extra/recipes-test/virt-reg-ut/virt-reg-ut.bb \
meta-qti-bsp/meta-qti-extra/recipes-test/virtio-i2c-test/virtio-i2c-test.bb \
meta-qti-bsp/meta-qti-extra/recipes-test/virt-fastrpc-ut/virt-fastrpc-ut_git.bb \
meta-qti-bsp/meta-qti-extra/recipes-test/virt-clk-ut/virt-clk-ut.bb \
meta-qti-bsp/meta-qti-extra/recipes-test/khab-test/khab-unit-test.bb \
meta-qti-bsp/meta-qti-base/recipes-virt/vhost-user-scmi/vhost-user-scmi_git.bb \
meta-qti-bsp/meta-qti-base/recipes-virt/vhost-user-q/vhost-user-q_git.bb \
meta-qti-bsp/meta-qti-base/recipes-virt/vhost-user-lib/vhost-user-lib_git.bb \
meta-qti-bsp/meta-qti-base/recipes-virt/vhost-device/vhost-device-i2c_0.1.0.bb \
meta-qti-bsp/meta-qti-base/recipes-virt/safelinux-system-cfg/safelinux-system-cfg_git.bb \
meta-qti-bsp/meta-qti-base/recipes-virt/qcrosvm/qcrosvm_git.bb \
meta-qti-bsp/meta-qti-base/recipes-virt/msmhab/msmhab_git.bb \
meta-qti-bsp/meta-qti-base/recipes-virt/hyp-udmabuf/hyp-udmabuf_git.bb \
meta-qti-bsp/meta-qti-base/recipes-virt/gunyah-drivers/gunyah-drivers_git.bb \
meta-qti-bsp/meta-qti-base/recipes-security/security-modules/safelinux-sec-modules_git.bb \
meta-qti-bsp/meta-qti-base/recipes-safelinux-dbg-modules/safelinux-dbg-modules/safelinux-dbg-modules_git.bb \
meta-qti-bsp/meta-qti-base/recipes-multimedia/virtio-video/virtio-video-header_git.bb \
meta-qti-bsp/meta-qti-base/recipes-multimedia/media/media_0.1.bb \
meta-qti-bsp/meta-qti-base/recipes-kiumd/safelinux-cfg-modules/safelinux-cfg-modules_git.bb \
meta-qti-bsp/meta-qti-base/recipes-kiumd/kiumd-headers/kiumd-headers_git.bb \
meta-qti-bsp/meta-qti-base/recipes-kiumd/gvm-net-config/gvm-net-config_git.bb \
meta-qti-bsp/meta-qti-base/recipes-kiumd/dspfirmware-mount/dspfirmware-mount_git.bb \
meta-qti-bsp/meta-qti-base/recipes-kernel/oot-dtbo/oot-dtbo.bb \
meta-qti-bsp/meta-qti-base/recipes-kernel/edk2/edk2_git.bb \
meta-qti-bsp/meta-qti-base/recipes-data/emac-dwc-eqos/emac-dwc-eqos_git.bb \
meta-qti-bsp/meta-qti-base/recipes-data/aurix-can/aurix-can_git.bb \
meta-qti-bsp/meta-qti-base/recipes-core/reboot-daemon/reboot-daemon_2.0.bb \
meta-qti-bsp/meta-qti-base/recipes-core/bootkpi-logging/bootkpi-logging.bb \
meta-qti-bsp/meta-qti-base/recipes-camera/cameradlkm/cameradlkm_0.2.bb \
meta-qti-bsp/meta-qti-base/recipes-audio/audiolite-dlkm/audiolite-dlkm_git.bb \
meta-qti-bsp/meta-qti-base/recipes-audio/audiolite-dlkm/audiolite-devicetree_git.bb \
meta-qti-bsp/meta-qti-base/recipes-kernel/linux-msm/linux-msm_5.15.bb \
meta-qti-bsp/meta-qti-extra/recipes-location/ \
"

# Missing recipes in baseline LV.AU.0.5.0 (target for quin-gvm-gen4 & qtiquingvm8295)
MISSING_RECIPE_SRCLIST_BASELINE_LV050 += "\
meta-qti-bsp/meta-qti-base/recipes-security/securemsm-devicetree/securemsm-devicetree.bb \
meta-qti-bsp/meta-qti-base/recipes-kernel/linux-msm/linux-msm-headers_6.12.bb \
meta-qti-bsp/meta-qti-base/recipes-kernel/linux-msm/qcom-dtc-native.bb \
meta-qti-bsp/meta-qti-base/recipes-graphics/graphics-hgsl/graphics-hgsldlkm_git.bb \
meta-qti-bsp/meta-qti-base/recipes-wlan/wlan-devicetree \
meta-qti-bsp/meta-qti-base/recipes-data/dataeth-dlkm/dataeth-dlkm_git.bb \
meta-qti-bsp/meta-qti-extra/recipes-security/selinux-policy/selinux-policy.bb \
meta-qti-bsp/meta-qti-base/recipes-display/display-la/display-la-headers.bb \
meta-qti-bsp/meta-qti-base/recipes-display/display-devicetree/display-devicetree_1.0.bb \
meta-qti-bsp/meta-qti-base/recipes-graphics/display-intf/display-intf-headers.bb \
meta-qti-bsp/meta-qti-base/recipes-audio/msm-virtio-snd/msm-virtio-snd.bb \
meta-qti-bsp/meta-qti-base/recipes-display/displaydlkm/msm-ext-display_git.bb \
meta-qti-bsp/meta-qti-base/recipes-multimedia/virtio-video/virtio-video_git.bb \
"

# Missing recipes in baseline LV.AU.0.5.1 (target for quin-gvm-gen4-5 & gvm-gen4-5)
MISSING_RECIPE_SRCLIST_BASELINE_LV051 += "\
meta-qti-bsp/meta-qti-extra/recipes-containers/softwarecontainer/softwarecontainer_git.bb \
meta-qti-bsp/meta-qti-base/recipes-camera/cameradlkm/cameradlkm_0.1.bb \
meta-qti-bsp/meta-qti-base/recipes-kernel/linux-msm/linux-msm_6.1.bb \
meta-qti-bsp/meta-qti-base/recipes-data/avb-utils/avb-utils_1.0.bb \
meta-qti-bsp/meta-qti-base/recipes-display/display-la/display-la-headers.bb \
meta-qti-bsp/meta-qti-base/recipes-display/display-devicetree/display-devicetree_1.0.bb \
meta-qti-bsp/meta-qti-base/recipes-graphics/display-intf/display-intf-headers.bb \
meta-qti-bsp/meta-qti-base/recipes-audio/msm-virtio-snd/msm-virtio-snd.bb \
meta-qti-bsp/meta-qti-base/recipes-display/displaydlkm/msm-ext-display_git.bb \
meta-qti-bsp/meta-qti-base/recipes-multimedia/virtio-video/virtio-video_git.bb \
"

# Missing recipes in baseline LV.AU.0.5.2 (target for gvm-gen5)
MISSING_RECIPE_SRCLIST_BASELINE_LV052 += "\
meta-qti-bsp/meta-qti-extra/recipes-containers/softwarecontainer/softwarecontainer_git.bb \
meta-qti-bsp/meta-qti-base/recipes-camera/cameradlkm/cameradlkm_0.1.bb \
meta-qti-bsp/meta-qti-base/recipes-wlan \
meta-qti-bsp/meta-qti-base/recipes-data/dataeth-dlkm/dataeth-dlkm_git.bb \
meta-qti-bsp/meta-qti-base/recipes-data/eavb/eavb-fe-virtio_git.bb \
meta-qti-bsp/meta-qti-base/recipes-connectivity/bt-dlkm/bt-dlkm_git.bb \
meta-qti-bsp/meta-qti-extra/recipes-security/selinux-policy/selinux-policy.bb \
meta-qti-display \
meta-qti-display-internal \
"
```

## meta-qti-base/conf/machine/quin-gvm-gen4-5.conf
```bitbake
#@TYPE: Machine
#@NAME: quin-gvm-gen4-5
#@DESCRIPTION: Machine configuration for QTI Quin GVM GEN4.5 Platform

BASEMACHINE ?= "quin-gvm-gen4-5"
include conf/machine/include/auto-common.inc

#MASK unused recipe in target
include conf/machine/include/gvm-bbmask.inc
include conf/distro/include/gvm-bbmask-prop.inc

include conf/machine/include/tune-cortexa78c.inc

PREFERRED_PROVIDER_dtc-native = "dtc-aosp-native"

PREFERRED_VERSION_linux-msm = "6.12"
PREFERRED_VERSION_linux-msm-headers = "6.12"
PREFERRED_VERSION_media-codec2 = "auto.1.0"
PREFERRED_VERSION_media-external = "auto.1.0"
PREFERRED_VERSION_media-noship = "auto.1.0"
PREFERRED_VERSION_codec2-service = "auto.1.0"

TUNE_CCARGS:remove:toolchain-clang = "-mbranch-protection=standard"

# gvm prefer camx
PREFERRED_VERSION_cameradlkm = "0.2"

KERNEL_ARCH = "autogvm"
KERNEL_VARIANT = "${@bb.utils.contains_any('VARIANT', 'perf user', 'perf_', 'debug_', d)}"
KERNEL_DEFCONFIG_VARIANT = "${@bb.utils.contains_any('VARIANT', 'perf user', 'defconfig', 'debug-defconfig', d)}"
KERNEL_OUT_VARIANT = "${@bb.utils.contains_any('VARIANT', 'perf user', '', 'debug_', d)}"
KERNEL_BUILD_CONFIG = "soc-repo/build.config.msm.${KERNEL_ARCH}.lv"
KERNEL_IMAGE_HEADER_VERSION = "2"

KERNEL_BASE = "0x80000000"
KERNEL_TAGS_OFFSET = "0x1e00000"
KERNEL_CONFIG = "${@['vendor/autogvm_defconfig', 'vendor/autogvm-debug_defconfig'][d.getVar('VARIANT', True) == ('' or 'debug')]}"
KERNEL_CMD_PARAMS = " "
KERNEL_IMAGETYPE = "Image"

KERNEL_CMD_PARAMS:append = "${@bb.utils.contains('MACHINE_FEATURES', 'early-ramdisk-init', ' rdinit=/sbin/early-ramdisk-init early-ramdisk.mode=3 ', '', d)}"
KERNEL_CMD_PARAMS:append = " ro "

EARLY_RAMDISK_KERNEL_MODULES = "\
    kernel-module-virtio-mmio-${KERNEL_VERSION} \
    kernel-module-failover-${KERNEL_VERSION} \
    kernel-module-net-failover-${KERNEL_VERSION} \
    kernel-module-virtio-net-${KERNEL_VERSION} \
    kernel-module-msm-hab-${KERNEL_VERSION} \
    kernel-module-crypto-qti-virt-${KERNEL_VERSION} \
    kernel-module-virtio-block-${KERNEL_VERSION} \
    kernel-module-virtio-blk-qti-crypto-${KERNEL_VERSION} \
    kernel-module-gh-dbl-${KERNEL_VERSION} \
    kernel-module-gh-msgq-${KERNEL_VERSION} \
    kernel-module-gh-arm-drv-${KERNEL_VERSION} \
    kernel-module-gh-rm-drv-${KERNEL_VERSION} \
    kernel-module-smem-${KERNEL_VERSION} \
    kernel-module-socinfo-dt-${KERNEL_VERSION} \
    kernel-module-boot-marker-${KERNEL_VERSION} \
"

MACHINE_FEATURES += "\
    qti-core \
    qti-tools \
    qti-hypervisor \
    qti-data \
    qti-dlkm \
    qti-multimedia \
    qti-security \
    qti-bluetooth \
    qti-adsp \
    qti-cdsp \
    qti-cdsp1 \
    qti-extra \
    qti-wlan \
    qti-wlan-hsp \
    qti-wlan-genoa \
    qti-camera \
    qti-graphics \
    qti-display \
    qti-audio-ar \
    qti-vnw \
    early-ramdisk-init \
    qti-gvm \
    dt-overlay \
    qti-cv \
"

MACHINE_FEATURES:remove = "\
    qti-lxc \
    qti-wlan-genoa \
"

SECTOOLS_VERSION = "sectools-v2"
SECTOOLS_SECURITY_PROFILE = "lemans_tz_security_profile.xml"
```

## meta-qti-base/conf/machine/sa7255-ivi.conf
```bitbake
#@TYPE: Machine
#@NAME: sa7255-ivi
#@DESCRIPTION: Machine configuration for QTI sa7255-ivi

BASEMACHINE = "sa7255-ivi"
include conf/machine/include/sa7255.inc

DEFAULTTUNE = "aarch64"
include conf/machine/include/arm/arch-armv8a.inc

RECOVERY_IMAGE = "0"

VARIANT_ID="ivi"

EXTRA_IMAGEDEPENDS += "edk2"
CLANG_BIN="${SRC_DIR_ROOT}/prebuilts/clang/host/linux-x86/clang-r416183b/bin/"

PREFERRED_PROVIDER_virtual/kernel = "linux-qcom-custom-rt"
PREFERRED_PROVIDER_virtual/kernel-headers = "linux-kernel-qcom-headers"
PREFERRED_VERSION_linux-qcom-custom-rt = "6.6"
preferred-kernel = "PREFERRED_VERSION_linux-qcom-custom-rt"
kernel-version = "${PREFERRED_VERSION_linux-qcom-custom-rt}"

KERNEL_ARCH = "gen4auto"
KERNEL_IMAGE_HEADER_VERSION = "2"
KERNEL_BASE = "0x80000000"
KERNEL_TAGS_OFFSET = "0x1e00000"
KERNEL_CONFIG = "defconfig"
KERNEL_BASE_DTB = "arch/arm64/boot/dts/qcom/sa7255p-ride.dtb"

KERNEL_CMD_PARAMS = "rw rootwait console=ttyMSM0,115200,n8 no_console_suspend=1 androidboot.hardware=qcom androidboot.console=ttyMSM0 lpm_levels.sleep_disabled=1 msm_rtb.filter=0x237 earlycon=qcom_geni,0x99c000 qcom_geni_serial.con_enabled=1 ignore_loglevel firmware_class.path=/firmware/vm/boot systemd.gpt_auto=0 cgroup.memory=nokmem,nosocket rcupdate.rcu_expedited=1 rcu_nocbs=0-7 rcupdate.rcu_normal_after_boot=0 qcom_scm.download_mode=1 page_owner=on pcie_pme=nomsi "
KERNEL_CMD_PARAMS:append = "${@bb.utils.contains('MACHINE_FEATURES', 'early-ramdisk-init', ' rdinit=/sbin/early-ramdisk-init early-ramdisk.mode=0 ', '', d)}"
KERNEL_CMD_PARAMS:remove = "${@bb.utils.contains_any('VARIANT', 'perf user', 'console=ttyMSM0,115200,n8', '', d)}"
KERNEL_CMD_PARAMS:remove = "${@bb.utils.contains_any('VARIANT', 'perf user', 'earlycon=qcom_geni,0x99c000 qcom_geni_serial.con_enabled=1', '', d)}"
KERNEL_CMD_PARAMS:remove = "${@bb.utils.contains_any('VARIANT', 'perf user', 'no_console_suspend=1', '', d)}"
KERNEL_CMD_PARAMS:remove = "${@bb.utils.contains_any('VARIANT', 'perf user', 'page_owner=on', '', d)}"
KERNEL_CMD_PARAMS:remove = "${@bb.utils.contains('IMAGE_FEATURES', 'read-only-rootfs', 'rw', '', d)}"
KERNEL_CMD_PARAMS:append = "${@bb.utils.contains('IMAGE_FEATURES', 'read-only-rootfs', 'ro', '', d)}"

KERNEL_IMAGETYPE = "Image"

OOT_DTBS = "out/sa7255p-ride-overlay.dtb"
OOT_DTBOS = "sa7255p-ride/sa7255p_overlay.dtbo \
             sa7255p-ride/sa7255p-v3_overlay.dtbo \
             sa7255p-ride/sa7255p-sw-eth-phy_overlay.dtbo"
```
