## meta-qti-base/conf/machine/sa7255.conf
```bitbake
#@TYPE: Machine
#@NAME: sa7255
#@DESCRIPTION: Machine configuration for QTI sa7255

BASEMACHINE = "sa7255"
include conf/machine/include/sa7255.inc

DEFAULTTUNE = "aarch64"
include conf/machine/include/arm/arch-armv8a.inc

RECOVERY_IMAGE = "0"

EXTRA_IMAGEDEPENDS += "edk2"
CLANG_BIN="${SRC_DIR_ROOT}/prebuilts/clang/host/linux-x86/clang-r416183b/bin/"

PREFERRED_PROVIDER_virtual/kernel = "linux-ark"
PREFERRED_PROVIDER_virtual/kernel-headers = "linux-ark-headers"
PREFERRED_VERSION_linux-ark = "5.14"
preferred-kernel = "${@oe.utils.ifelse(d.getVar('PREFERRED_PROVIDER_virtual/kernel') == 'linux-ark', 'PREFERRED_VERSION_linux-ark', 'PREFERRED_VERSION_linux-msm')}"
kernel-version = "${@oe.utils.ifelse(d.getVar('PREFERRED_PROVIDER_virtual/kernel') == 'linux-ark', '5.14', '5.4')}"
KERNEL_IMAGE_HEADER_VERSION = "2"
KERNEL_BASE = "0x80000000"
KERNEL_TAGS_OFFSET = "0x1e00000"
KERNEL_CONFIG = "defconfig"
RH_KERNEL_NAME = "rh-kernel-5.14"

KERNEL_CMD_PARAMS = "rw rootwait console=ttyMSM0,115200,n8 no_console_suspend=1 androidboot.hardware=qcom androidboot.console=ttyMSM0 lpm_levels.sleep_disabled=1 msm_rtb.filter=0x237 earlycon=qcom_geni,0x99c000 qcom_geni_serial.con_enabled=1 loglevel=4 firmware_class.path=/firmware/vm/boot systemd.gpt_auto=0 cgroup.memory=nokmem,nosocket rcupdate.rcu_expedited=1 rcu_nocbs=0-7 rcupdate.rcu_normal_after_boot=0 pcie_pme=nomsi "
KERNEL_CMD_PARAMS:append = "${@bb.utils.contains('MACHINE_FEATURES', 'early-ramdisk-init', ' rdinit=/sbin/early-ramdisk-init early-ramdisk.mode=0 ', '', d)}"
KERNEL_CMD_PARAMS:remove = "${@bb.utils.contains_any('VARIANT', 'perf user', 'console=ttyMSM0,115200,n8', '', d)}"
KERNEL_CMD_PARAMS:remove = "${@bb.utils.contains_any('VARIANT', 'perf user', 'earlycon=qcom_geni,0x99c000 qcom_geni_serial.con_enabled=1', '', d)}"
KERNEL_CMD_PARAMS:remove = "${@bb.utils.contains_any('VARIANT', 'perf user', 'no_console_suspend=1', '', d)}"
KERNEL_CMD_PARAMS:remove = "${@bb.utils.contains('IMAGE_FEATURES', 'read-only-rootfs', 'rw', '', d)}"
KERNEL_CMD_PARAMS:append = "${@bb.utils.contains('IMAGE_FEATURES', 'read-only-rootfs', 'ro', '', d)}"

KERNEL_IMAGETYPE = "Image.gz"

OOT_DTBS = "\
    sa7255p-ride/sa7255p-ride_rh.dtb \
    sa8620p-ride/sa8620p-ride_rh.dtb \
"

EARLY_RAMDISK_KERNEL_MODULES = "\
    kernel-module-pinctrl-msm-${KERNEL_VERSION} \
    kernel-module-rpmhpd-${KERNEL_VERSION} \
    kernel-module-qcom-geni-se-${KERNEL_VERSION} \
    kernel-module-qcom-geni-serial-${KERNEL_VERSION} \
    kernel-module-qcom-ipcc-${KERNEL_VERSION} \
    kernel-module-icc-bcm-voter-${KERNEL_VERSION} \
    kernel-module-icc-rpmh-${KERNEL_VERSION} \
    kernel-module-qcom-rpmh-regulator-${KERNEL_VERSION} \
    kernel-module-phy-qcom-qmp-ufs-${KERNEL_VERSION} \
    kernel-module-ufs-qcom-${KERNEL_VERSION} \
    kernel-module-governor-simpleondemand-${KERNEL_VERSION} \
    kernel-module-ufshcd-core-${KERNEL_VERSION} \
    kernel-module-ufshcd-pltfrm-${KERNEL_VERSION} \
    kernel-module-spmi-pmic-arb-${KERNEL_VERSION} \
    kernel-module-pinctrl-spmi-gpio-${KERNEL_VERSION} \
    kernel-module-pinctrl-spmi-mpp-${KERNEL_VERSION} \
    kernel-module-nvmem-qcom-spmi-sdam-${KERNEL_VERSION} \
    kernel-module-aquantia-${KERNEL_VERSION}  \
    kernel-module-marvell-${KERNEL_VERSION} \
    kernel-module-pinctrl-sa7255p-${KERNEL_VERSION} \
    kernel-module-qnoc-sa7255p-${KERNEL_VERSION} \
    kernel-module-gcc-sa7255p-${KERNEL_VERSION} \
    kernel-module-camcc-sa8775p-${KERNEL_VERSION} \
    kernel-module-dispcc-sa7255p-${KERNEL_VERSION} \
    kernel-module-gpucc-sa8775p-${KERNEL_VERSION} \
    kernel-module-videocc-sa8775p-${KERNEL_VERSION} \
"
```

## meta-qti-base/conf/machine/sa81x5.conf
```bitbake
#@TYPE: Machine
#@NAME: sa81x5
#@DESCRIPTION: Machine configuration for QTI sa81x5

BASEMACHINE = "sa81x5"
include conf/machine/include/auto-common.inc

#sa81x5 board chip belongs to cortexa76-cortexa55
include conf/machine/include/tune-cortexa76-cortexa55.inc

PREFERRED_PROVIDER_dtc-native = "dtc-aosp-native"

PREFERRED_VERSION_linux-msm = "5.15"

PREFERRED_VERSION_adsprpc = "2.0"
PREFERRED_VERSION_edk2 = "4.0"

RECOVERY_IMAGE = "0"

KERNEL_ARCH = "gen3auto"
KERNEL_VARIANT = "${@bb.utils.contains_any('VARIANT', 'perf user', 'perf_', 'debug_', d)}"
KERNEL_BUILD_CONFIG = "msm-kernel/build.config.msm.${KERNEL_ARCH}.lxc"
KERNEL_IMAGE_HEADER_VERSION = "2"
KERNEL_RAMDISK_DLKMS = "False"

KERNEL_BASE = "0x80000000"
KERNEL_TAGS_OFFSET = "0x1e00000"
KERNEL_CMD_PARAMS = "console=ttyMSM0,115200n8 earlycon=qcom_geni,0xa90000 qcom_geni_serial.con_enabled=1 androidboot.first_stage_console=1 rootfstype=ext4 rw rootwait firmware_class.path=/firmware/image/ pd_ignore_unused pcie_ports=compat systemd.unified_cgroup_hierarchy=1 systemd.gpt_auto=0 "
KERNEL_CMD_PARAMS:append = " fsck.repair=yes "
KERNEL_CMD_PARAMS:append = "${@bb.utils.contains('MACHINE_FEATURES', 'early-ramdisk-init', ' rdinit=/sbin/early-ramdisk-init early-ramdisk.mode=1 ', '', d)}"
KERNEL_CMD_PARAMS:append = "${@bb.utils.contains_any('VARIANT', 'perf user', 'no_hotplug_area=0x80000000,0x60000000 dyn_memhotplug ', '', d)}"
KERNEL_CMD_PARAMS:append = "${@bb.utils.contains('DISTRO_FEATURES', 'early_init', 'early_userspace ', '', d)}"
KERNEL_CMD_PARAMS:remove = "${@bb.utils.contains_any('VARIANT', 'perf user', 'console=ttyMSM0,115200n8', '', d)}"
KERNEL_CMD_PARAMS:remove = "${@bb.utils.contains_any('VARIANT', 'perf user', 'earlycon=qcom_geni,0xa90000', '', d)}"
KERNEL_CMD_PARAMS:remove = "${@bb.utils.contains_any('VARIANT', 'perf user', 'qcom_geni_serial.con_enabled=1', '', d)}"
KERNEL_CMD_PARAMS:remove = "${@bb.utils.contains('IMAGE_FEATURES', 'read-only-rootfs', 'rw', '', d)}"
KERNEL_CMD_PARAMS:append = "${@bb.utils.contains('DISTRO_FEATURES', 'qti-lxc', ' androidboot.android_dt_dir=/skip/ ', '', d)}"
KERNEL_CMD_PARAMS:append = "${@bb.utils.contains('DISTRO_FEATURES', 'qti-lxc', ' androidboot.console=tty30', '', d)}"
KERNEL_CMD_PARAMS:append = "${@bb.utils.contains('DISTRO_FEATURES', 'qti-lxc', ' androidboot.selinux=permissive', '', d)}"
KERNEL_CMD_PARAMS:append = "${@bb.utils.contains('DISTRO_FEATURES', 'qti-lxc', ' androidboot.hardware=qcom', '', d)}"
KERNEL_CMD_PARAMS:remove = "${@bb.utils.contains('DISTRO_FEATURES', 'qti-lxc', ' systemd.unified_cgroup_hierarchy=1', '', d)}"
KERNEL_IMAGETYPE = "Image"

KERNEL_MODULE_PROBECONF += "stmmac"
module_conf_stmmac = "softdep stmmac pre: micrel"

# bootloader configuration
EXTRA_IMAGEDEPENDS += "edk2"

IMAGE_FEATURES:append = " read-only-rootfs"

MACHINE_FEATURES += "\
    qti-adsp \
    qti-cdsp \
    qti-core \
    qti-extra \
    qti-lxc \
    qti-graphics \
    qti-camera \
    qti-security \
    dt-overlay \
    qti-audio \
    qti-display \
    qti-multimedia \
    qti-data \
    qti-tools \
    qti-vnw \
    goldcore-boot \
    qti-ml \
    early-ramdisk-init \
    qti-dlkm \
    vendor-boot-image \
"

MACHINE_FEATURES:remove = "\
    qti-bluetooth \
    qti-location \
"

SECTOOLS_VERSION = "sectools-v1"

EARLY_RAMDISK_KERNEL_MODULES = "\
    kernel-module-spidev-${KERNEL_VERSION} \
    kernel-module-spi-msm-geni-${KERNEL_VERSION} \
    kernel-module-qcom-smd-${KERNEL_VERSION} \
    kernel-module-rproc-qcom-common-${KERNEL_VERSION} \
    kernel-module-qcom-ramdump-${KERNEL_VERSION} \
    kernel-module-qmi-helpers-${KERNEL_VERSION} \
    kernel-module-qcom-sysmon-${KERNEL_VERSION} \
    kernel-module-qcom-q6v5-${KERNEL_VERSION} \
    kernel-module-qcom-pil-info-${KERNEL_VERSION} \
    kernel-module-mdt-loader-${KERNEL_VERSION} \
    kernel-module-smp2p-${KERNEL_VERSION} \
    kernel-module-qcom-q6v5-pas-${KERNEL_VERSION} \
    kernel-module-pinctrl-spmi-gpio-${KERNEL_VERSION} \
    kernel-module-gpucc-sm8150-${KERNEL_VERSION} \
    kernel-module-sg-${KERNEL_VERSION} \
    kernel-module-dcvs-fp-${KERNEL_VERSION} \
    kernel-module-qcom-dcvs-${KERNEL_VERSION} \
    kernel-module-mdt-loader-${KERNEL_VERSION} \
    kernel-module-i2c-msm-geni-${KERNEL_VERSION} \
    kernel-module-pinctrl-sx150x-${KERNEL_VERSION} \
    kernel-module-i2c-mux-${KERNEL_VERSION} \
    kernel-module-i2c-mux-pca954x-${KERNEL_VERSION} \
    kernel-module-anx7625-${KERNEL_VERSION} \
    securemsmdlkm \
    displaydlkm \
    kernel-module-videocc-sm8150-${KERNEL_VERSION} \
    kernel-module-mdt-loader-${KERNEL_VERSION} \
    videodlkm \
    kernel-module-stub-regulator-${KERNEL_VERSION} \
    cameradlkm \
"
```

## meta-qti-base/conf/machine/sa8620-adas.conf
```bitbake
#@TYPE: Machine
#@NAME: sa8620-adas
#@DESCRIPTION: Machine configuration for QTI sa8620-adas

BASEMACHINE = "sa8620-adas"
include conf/machine/include/sa7255.inc

DEFAULTTUNE = "aarch64"
include conf/machine/include/arm/arch-armv8a.inc

RECOVERY_IMAGE = "0"

VARIANT_ID="adas"

EXTRA_IMAGEDEPENDS += "edk2"
CLANG_BIN="${SRC_DIR_ROOT}/prebuilts/clang/host/linux-x86/clang-r416183b/bin/"

PREFERRED_PROVIDER_virtual/kernel = "linux-qcom-custom-rt"
PREFERRED_PROVIDER_virtual/kernel-headers = "linux-kernel-qcom-headers"
PREFERRED_VERSION_linux-qcom-custom-rt = "6.6"
preferred-kernel = "PREFERRED_VERSION_linux-qcom-custom-rt"
kernel-version = "${PREFERRED_VERSION_linux-qcom-custom-rt}"

KERNEL_ARCH = "gen4auto"
KERNEL_IMAGE_HEADER_VERSION = "2"
KERNEL_BASE = "0x80000000"
KERNEL_TAGS_OFFSET = "0x1e00000"
KERNEL_CONFIG = "defconfig"

KERNEL_CMD_PARAMS = "rw rootwait console=ttyMSM0,115200,n8 no_console_suspend=1 androidboot.hardware=qcom androidboot.console=ttyMSM0 lpm_levels.sleep_disabled=1 msm_rtb.filter=0x237 earlycon=qcom_geni,0x99c000 qcom_geni_serial.con_enabled=1 loglevel=4 firmware_class.path=/firmware/vm/boot systemd.gpt_auto=0 cgroup.memory=nokmem,nosocket rcupdate.rcu_expedited=1 rcu_nocbs=0-7 rcupdate.rcu_normal_after_boot=0 qcom_scm.download_mode=1 page_owner=on  pcie_pme=nomsi "
KERNEL_CMD_PARAMS:append = "${@bb.utils.contains('MACHINE_FEATURES', 'early-ramdisk-init', ' rdinit=/sbin/early-ramdisk-init early-ramdisk.mode=0 ', '', d)}"
KERNEL_CMD_PARAMS:remove = "${@bb.utils.contains_any('VARIANT', 'perf user', 'console=ttyMSM0,115200,n8', '', d)}"
KERNEL_CMD_PARAMS:remove = "${@bb.utils.contains_any('VARIANT', 'perf user', 'earlycon=qcom_geni,0x99c000 qcom_geni_serial.con_enabled=1', '', d)}"
KERNEL_CMD_PARAMS:remove = "${@bb.utils.contains_any('VARIANT', 'perf user', 'no_console_suspend=1', '', d)}"
KERNEL_CMD_PARAMS:remove = "${@bb.utils.contains_any('VARIANT', 'perf user', 'page_owner=on', '', d)}"
KERNEL_CMD_PARAMS:remove = "${@bb.utils.contains('IMAGE_FEATURES', 'read-only-rootfs', 'rw', '', d)}"
KERNEL_CMD_PARAMS:append = "${@bb.utils.contains('IMAGE_FEATURES', 'read-only-rootfs', 'ro', '', d)}"

KERNEL_IMAGETYPE = "Image"

OOT_DTBS = "sa8620p-ride/sa8620p-ride.dtb \
            sa8620p-ride/sa8620p-ride-v3.dtb \
            sa8620p-ride/sa8620p-sw-eth-phy.dtb"

MACHINE_FEATURES:remove = "\
    qti-vmm \
    qti-audio-ar \
"

MACHINE_FEATURES:append = " qti-rideware"
```

## meta-qti-base/conf/machine/sa8650-adas.conf
```bitbake
#@TYPE: Machine
#@NAME: sa8650-adas
#@DESCRIPTION: Machine configuration for QTI sa8650-adas

BASEMACHINE = "sa8650-adas"
include conf/machine/include/sa8775.inc

RECOVERY_IMAGE = "0"

VARIANT_ID="adas"

EXTRA_IMAGEDEPENDS += "edk2"
CLANG_BIN="${SRC_DIR_ROOT}/prebuilts/clang/host/linux-x86/clang-r416183b/bin/"

PREFERRED_PROVIDER_virtual/kernel = "linux-qcom-custom-rt"
PREFERRED_PROVIDER_virtual/kernel-headers = "linux-kernel-qcom-headers"
PREFERRED_VERSION_linux-qcom-custom-rt = "6.6"
preferred-kernel = "PREFERRED_VERSION_linux-qcom-custom-rt"
kernel-version = "${PREFERRED_VERSION_linux-qcom-custom-rt}"

KERNEL_ARCH = "gen4auto"
KERNEL_IMAGE_HEADER_VERSION = "2"
KERNEL_BASE = "0x80000000"
KERNEL_TAGS_OFFSET = "0x1e00000"
KERNEL_CONFIG = "defconfig"
KERNEL_BASE_DTB = "arch/arm64/boot/dts/qcom/sa8255p-ride.dtb"

KERNEL_CMD_PARAMS = "rw rootwait console=ttyMSM0,115200,n8 no_console_suspend=1 androidboot.hardware=qcom androidboot.console=ttyMSM0 lpm_levels.sleep_disabled=1 msm_rtb.filter=0x237 earlycon=qcom_geni,0xa8c000 firmware_class.path=/firmware/vm/boot systemd.gpt_auto=0 cgroup.memory=nokmem,nosocket systemd.unified_cgroup_hierarchy=1 qcom_scm.download_mode=1 rcupdate.rcu_expedited=1 rcu_nocbs=0-7 rcupdate.rcu_normal_after_boot=0 page_owner=on quiet systemd.show_status=1 systemd.service_watchdogs=0 pcie_pme=nomsi "
KERNEL_CMD_PARAMS:append = "${@bb.utils.contains('MACHINE_FEATURES', 'early-ramdisk-init', ' rdinit=/sbin/early-ramdisk-init early-ramdisk.mode=1 ', '', d)}"
KERNEL_CMD_PARAMS:remove = "${@bb.utils.contains_any('VARIANT', 'perf user', 'console=ttyMSM0,115200,n8', '', d)}"
KERNEL_CMD_PARAMS:remove = "${@bb.utils.contains_any('VARIANT', 'perf user', 'earlycon=qcom_geni,0xa8c000', '', d)}"
KERNEL_CMD_PARAMS:remove = "${@bb.utils.contains_any('VARIANT', 'perf user', 'no_console_suspend=1', '', d)}"
KERNEL_CMD_PARAMS:remove = "${@bb.utils.contains_any('VARIANT', 'perf user', 'page_owner=on', '', d)}"
KERNEL_CMD_PARAMS:remove = "${@bb.utils.contains('IMAGE_FEATURES', 'read-only-rootfs', 'rw', '', d)}"
KERNEL_CMD_PARAMS:append = "${@bb.utils.contains_any('VARIANT', 'perf user', ' no_hotplug_area=0x80000000,0x80000000;0x252000000,0x1a8d00000;0xea0000000,0xc1d00000 dyn_memhotplug ', '', d)}"

KERNEL_IMAGETYPE = "Image"

OOT_DTBOS = "sa8650p-ride/sa8650p_overlay.dtbo \
             sa8650p-ride/sa8650p-v3_overlay.dtbo \
             sa8650p-ride/sa8650p_overlay_pcie_ep.dtbo \
             sa8650p-ride/sa8650p-sw-eth-phy_overlay.dtbo \
             sa8650p-ride/sa8650p-ride-mx_overlay.dtbo"

OOT_DDR_DTBOS = "sa8650p-ride/sa8650p-ddr-12gb_overlay.dtbo \
                 sa8650p-ride/sa8650p-ddr-18gb_overlay.dtbo \
                 sa8650p-ride/sa8650p-ddr-24gb_overlay.dtbo \
                 sa8650p-ride/sa8650p-ddr-36gb_overlay.dtbo"

FACTORY_TEST_VAL = "0"

MACHINE_FEATURES:remove = "\
    qti-vmm \
"

MACHINE_FEATURES:append = " qti-rideware"

EARLY_RAMDISK_KERNEL_MODULES:remove = "\
    kernel-module-ipcc-shmem-test-module-${KERNEL_VERSION} \
"
```
