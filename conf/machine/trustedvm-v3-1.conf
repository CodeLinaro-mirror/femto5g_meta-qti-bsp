## meta-qti-base/conf/machine/sa8775-flex.conf
```bitbake
#@TYPE: Machine
#@NAME: sa8775-flex
#@DESCRIPTION: Machine configuration for QTI sa8775-flex

BASEMACHINE = "sa8775-flex"
include conf/machine/include/sa8775.inc

RECOVERY_IMAGE = "0"

VARIANT_ID="flex"

EXTRA_IMAGEDEPENDS += "edk2"
CLANG_BIN="${SRC_DIR_ROOT}/prebuilts/clang/host/linux-x86/clang-r416183b/bin/"

PREFERRED_PROVIDER_virtual/kernel = "linux-qcom-custom-rt"
PREFERRED_PROVIDER_virtual/kernel-headers = "linux-kernel-qcom-headers"
PREFERRED_VERSION_linux-qcom-custom-rt = "6.6"
preferred-kernel = "PREFERRED_VERSION_linux-qcom-custom-rt"
kernel-version = "${PREFERRED_VERSION_linux-qcom-custom-rt}"

KERNEL_ARCH = "gen4auto"
KERNEL_IMAGE_HEADER_VERSION = "2"
KERNEL_BASE = "0x80000000"
KERNEL_TAGS_OFFSET = "0x1e00000"
KERNEL_CONFIG = "defconfig"
KERNEL_BASE_DTB = "arch/arm64/boot/dts/qcom/sa8255p-ride.dtb"

KERNEL_CMD_PARAMS = "rw rootwait console=ttyMSM0,115200,n8 no_console_suspend=1 androidboot.hardware=qcom androidboot.console=ttyMSM0 lpm_levels.sleep_disabled=1 msm_rtb.filter=0x237 earlycon=qcom_geni,0xa8c000 firmware_class.path=/firmware/vm/boot systemd.gpt_auto=0 cgroup.memory=nokmem,nosocket systemd.unified_cgroup_hierarchy=1 qcom_scm.download_mode=1 rcupdate.rcu_expedited=1 rcu_nocbs=0-7 rcupdate.rcu_normal_after_boot=0 page_owner=on quiet systemd.show_status=1 pcie_pme=nomsi "
KERNEL_CMD_PARAMS:append = "${@bb.utils.contains('MACHINE_FEATURES', 'early-ramdisk-init', ' rdinit=/sbin/early-ramdisk-init early-ramdisk.mode=1 ', '', d)}"
KERNEL_CMD_PARAMS:remove = "${@bb.utils.contains_any('VARIANT', 'perf user', 'console=ttyMSM0,115200,n8', '', d)}"
KERNEL_CMD_PARAMS:remove = "${@bb.utils.contains_any('VARIANT', 'perf user', 'earlycon=qcom_geni,0xa8c000', '', d)}"
KERNEL_CMD_PARAMS:remove = "${@bb.utils.contains_any('VARIANT', 'perf user', 'no_console_suspend=1', '', d)}"
KERNEL_CMD_PARAMS:remove = "${@bb.utils.contains_any('VARIANT', 'perf user', 'page_owner=on', '', d)}"
KERNEL_CMD_PARAMS:remove = "${@bb.utils.contains('IMAGE_FEATURES', 'read-only-rootfs', 'rw', '', d)}"
KERNEL_CMD_PARAMS:append = "${@bb.utils.contains_any('VARIANT', 'perf user', ' no_hotplug_area=0x80000000,0x280000000;0xa30000000,0x190000000;0xd00000000,0xC0000000;0xe80000000,0x83000000 dyn_memhotplug ', '', d)}"

OOT_DTBOS = "sa8775p_overlay.dtbo \
             sa8775p-v3_overlay.dtbo \
             sa8775p_overlay_pcie_ep.dtbo \
             sa8775p-sw-eth-phy_overlay.dtbo"

KERNEL_IMAGETYPE = "Image"

OOT_DTBS = "sa8775p-ride-mx/sa8775p-ride-mx.dtb"
```

## meta-qti-base/conf/machine/sa8775.conf
```bitbake
#@TYPE: Machine
#@NAME: sa8775
#@DESCRIPTION: Machine configuration for QTI sa8775

BASEMACHINE = "sa8775"
include conf/machine/include/sa8775.inc

RECOVERY_IMAGE = "0"

EXTRA_IMAGEDEPENDS += "edk2"
CLANG_BIN="${SRC_DIR_ROOT}/prebuilts/clang/host/linux-x86/clang-r416183b/bin/"

PREFERRED_PROVIDER_virtual/kernel = "linux-ark"
PREFERRED_PROVIDER_virtual/kernel-headers = "linux-ark-headers"
PREFERRED_VERSION_linux-ark = "5.14"
preferred-kernel = "${@oe.utils.ifelse(d.getVar('PREFERRED_PROVIDER_virtual/kernel') == 'linux-ark', 'PREFERRED_VERSION_linux-ark', 'PREFERRED_VERSION_linux-msm')}"
kernel-version = "${@oe.utils.ifelse(d.getVar('PREFERRED_PROVIDER_virtual/kernel') == 'linux-ark', '5.14', '5.4')}"

KERNEL_IMAGE_HEADER_VERSION = "2"
KERNEL_BASE = "0x80000000"
KERNEL_TAGS_OFFSET = "0x1e00000"
KERNEL_CONFIG = "defconfig"
RH_KERNEL_NAME = "rh-kernel-5.14"
KERNEL_BASE_DTB = "arch/arm64/boot/dts/qcom/sa8775p-ride-fw-managed.dtb"
EARLY_RAMDISK_MODE = "${@bb.utils.contains_any('VARIANT', 'perf user', '1', '0', d)}"

KERNEL_CMD_PARAMS = "rw rootwait console=ttyMSM0,115200,n8 no_console_suspend=1 androidboot.hardware=qcom androidboot.console=ttyMSM0 lpm_levels.sleep_disabled=1 msm_rtb.filter=0x237 earlycon=qcom_geni,0xa8c000 loglevel=4 firmware_class.path=/firmware/vm/boot systemd.gpt_auto=0 cgroup.memory=nokmem,nosocket systemd.unified_cgroup_hierarchy=1 rcupdate.rcu_expedited=1 rcu_nocbs=0-7 rcupdate.rcu_normal_after_boot=0 pcie_pme=nomsi "
KERNEL_CMD_PARAMS:append = "${@bb.utils.contains('MACHINE_FEATURES', 'early-ramdisk-init', ' rdinit=/sbin/early-ramdisk-init early-ramdisk.mode=${EARLY_RAMDISK_MODE} ', '', d)}"
KERNEL_CMD_PARAMS:remove = "${@bb.utils.contains_any('VARIANT', 'perf user', 'console=ttyMSM0,115200,n8', '', d)}"
KERNEL_CMD_PARAMS:remove = "${@bb.utils.contains_any('VARIANT', 'perf user', 'earlycon=qcom_geni,0xa8c000', '', d)}"
KERNEL_CMD_PARAMS:remove = "${@bb.utils.contains_any('VARIANT', 'perf user', 'no_console_suspend=1', '', d)}"
KERNEL_CMD_PARAMS:remove = "${@bb.utils.contains('IMAGE_FEATURES', 'read-only-rootfs', 'rw', '', d)}"

KERNEL_IMAGETYPE = "Image.gz"

OOT_DTBS = "sa8775p-ride-mx/sa8775p-ride-mx_rh.dtb"

EARLY_RAMDISK_KERNEL_MODULES = "\
    kernel-module-pinctrl-msm-${KERNEL_VERSION} \
    kernel-module-qcom-geni-se-${KERNEL_VERSION} \
    kernel-module-qcom-geni-serial-${KERNEL_VERSION} \
    kernel-module-qcom-ipcc-${KERNEL_VERSION} \
    kernel-module-phy-qcom-qmp-ufs-${KERNEL_VERSION} \
    kernel-module-ufs-qcom-${KERNEL_VERSION} \
    kernel-module-governor-simpleondemand-${KERNEL_VERSION} \
    kernel-module-ufshcd-core-${KERNEL_VERSION} \
    kernel-module-ufshcd-pltfrm-${KERNEL_VERSION} \
    kernel-module-pinctrl-sa8775p-${KERNEL_VERSION} \
    kernel-module-aquantia-${KERNEL_VERSION}  \
    kernel-module-marvell-${KERNEL_VERSION} \
    kernel-module-virtio-mmio-${KERNEL_VERSION} \
    kernel-module-ipv6-${KERNEL_VERSION} \
    kernel-module-iommufd-${KERNEL_VERSION} \
    kernel-module-kiumd-${KERNEL_VERSION} \
    kernel-module-iommu-iova-map-${KERNEL_VERSION} \
    kernel-module-scm-user-intf-${KERNEL_VERSION} \
    kernel-module-vfio-${KERNEL_VERSION} \
    kernel-module-vfio-iommu-type1-${KERNEL_VERSION} \
    kernel-module-vfio-platform-base-${KERNEL_VERSION} \
    kernel-module-vfio-platform-${KERNEL_VERSION} \
    kernel-module-kiumd-kgsl-${KERNEL_VERSION} \
    kernel-module-vfio-iommu-qcom-${KERNEL_VERSION} \
    kernel-module-ipcc-shmem-test-module-${KERNEL_VERSION} \
    kernel-module-smem-${KERNEL_VERSION} \
    kernel-module-gh-msgq-${KERNEL_VERSION} \
    kernel-module-gh-rm-drv-${KERNEL_VERSION} \
    kernel-module-hvc-gunyah-${KERNEL_VERSION} \
    kernel-module-hyp-udmabuf-${KERNEL_VERSION} \
    kernel-module-mdt-loader-${KERNEL_VERSION} \
    kernel-module-gunyah-${KERNEL_VERSION} \
    kernel-module-i2c-qcom-geni-${KERNEL_VERSION} \
    kernel-module-i2c-dev-${KERNEL_VERSION} \
    kernel-module-qcom-scm-oot-${KERNEL_VERSION} \
    kernel-module-qtee-shmbridge-${KERNEL_VERSION} \
    kernel-module-smcinvoke-${KERNEL_VERSION} \
    kernel-module-spidev-${KERNEL_VERSION} \
    kernel-module-qcom-dload-mode-${KERNEL_VERSION} \
    kernel-module-qcom-uscmi-${KERNEL_VERSION} \
    kernel-module-mhi-ep-net-${KERNEL_VERSION} \
    kernel-module-kryo-arm64-edac-${KERNEL_VERSION} \
    kernel-module-qcom-hwspinlock-${KERNEL_VERSION} \
    kernel-module-socinfo-${KERNEL_VERSION} \
    kernel-module-qcom-l3-cache-config-${KERNEL_VERSION} \
"

EXTERNAL_BOOTUP_KERNEL_MODULES = " \
    kernel-module-phy-qcom-qmp-usb-${KERNEL_VERSION} \
    kernel-module-dwc3-qcom-${KERNEL_VERSION} \
    kernel-module-dwc3-${KERNEL_VERSION} \
    kernel-module-usb-storage-${KERNEL_VERSION} \
    kernel-module-uas-${KERNEL_VERSION} \
    kernel-module-phy-qcom-snps-femto-v2-${KERNEL_VERSION} \
"

EARLY_RAMDISK_KERNEL_MODULES:append = " \
    ${@bb.utils.contains('DISTRO_FEATURES', 'qti-external-boot', '${EXTERNAL_BOOTUP_KERNEL_MODULES}', '', d)} \
"

ROOT_HOME = "/root"

MACHINE_FEATURES:append = " qti-rideware"
```

## meta-qti-distro/conf/distro/auto-gvm-headless.conf
```bitbake
require conf/distro/include/auto-common.inc

DISTRO_NAME = "auto gvm headless"

PRODUCT = "${MACHINE}-headless"
PRODUCT:gvm-gen4-5 = "gvm-gen4-5-hl"
PRODUCT:quin-gvm-gen4-5 = "gvm-gen4-5-hl"
PRODUCT:quin-tgvm-gen4-5 = "quin-tgvm-gen4-5-hl"

DEPLOY_NAME_BASE:gvm-gen4-5 = "${PRODUCT}"
DEPLOY_NAME_BASE:quin-gvm-gen4-5 = "${PRODUCT}"

ROOT_HOME:gvm-gen4-5 = "/root"
IMAGE_ROOTFS_SIZE:gvm-gen4-5 = "716800"

BBMASK:quin-tgvm-gen4 += "meta-qti-bsp/meta-qti-distro/recipes-core/images/machine-image-initramfs.bb"
BBMASK:quin-tgvm-gen4 += "meta-qti-bsp/meta-qti-headless/recipes-kernel/linux-msm/linux-msm_6.12.bb"
BBMASK:quin-tgvm-gen4 += "meta-qti-bsp/meta-qti-headless/recipes-kernel/linux-msm/linux-msm-headers_6.12.bb"
BBMASK:quin-tgvm-gen4 += "meta-qti-bsp/meta-qti-headless/recipes-security/securemsm-devicetree/securemsm-devicetree.bb"
BBMASK:quin-tgvm-gen4 += "meta-qti-bsp/meta-qti-headless/recipes-kernel/linux-msm/qcom-dtc-native.bb"
BBMASK:quin-tgvm-gen4 += "meta-qti-bsp-prop/meta-qti-headless-prop/recipes-security/mink/mink.bb"
BBMASK:quin-tgvm-gen4-5 += "meta-qti-bsp/meta-qti-distro/recipes-core/images/machine-image-initramfs.bb"
BBMASK:quin-tgvm-gen4-5 += "meta-qti-bsp/meta-qti-headless/recipes-kernel/linux-msm/linux-msm_6.1.bb"
BBMASK:quin-tgvm-gen4-5 += "meta-qti-bsp/meta-qti-headless/recipes-kernel/toolchain/kernel-toolchain-native_5.15.bb"
BBMASK:quin-tgvm-gen4-5 += "meta-qti-bsp-prop/meta-qti-headless-prop/recipes-kernel/kernel-devicetree/kernel-devicetree.bb"

DISTRO_FEATURES:remove = " wifi"
DISTRO_FEATURES:append:quin-tgvm-gen4 = " selinux"
DISTRO_FEATURES_NATIVE:append:quin-tgvm-gen4 = " selinux"

DISTRO_FEATURES:append = " \
    qti-core \
    qti-data \
    qti-extra \
    qti-graphics \
    qti-hypervisor \
    qti-security \
    qti-avb \
    qti-fde \
    qti-tools \
    ab-boot-support \
"

# Preferred refpolicy
PREFERRED_PROVIDER_virtual/refpolicy = "refpolicy-targeted"
DEFAULT_ENFORCING = "enforcing"

DISTRO_FEATURES:remove:gvm-gen4-5 = " \
    qti-extra \
    qti-graphics \
    qti-bluetooth \
"

DISTRO_FEATURES:remove:quin-gvm-gen4-5 = " \
    qti-extra \
    qti-graphics \
    qti-bluetooth \
"
```

## meta-qti-distro/conf/distro/auto-gvm-virtio.conf
```bitbake
require conf/distro/include/auto-common.inc

DISTRO_NAME = "Auto Gvm VirtIO"

PRODUCT = "${MACHINE}"

DISTRO_FEATURES:append = " \
    qti-adsp \
    qti-cdsp \
    qti-cdsp1 \
    qti-core \
    qti-data \
    qti-extra \
    qti-tools \
    qti-security \
    qti-avb \
    qti-virtio \
    ab-boot-support \
"
BBMASK += "meta-qti-bsp/meta-qti-distro/recipes-core/images/machine-image-initramfs.bb"
BBMASK += "meta-qti-bsp-prop/meta-qti-headless-prop/recipes-security/mink/mink.bb"
BBMASK += "meta-qti-bsp/meta-qti-headless/recipes-kernel/linux-msm/linux-msm_6.1.bb"
BBMASK += "meta-qti-bsp/meta-qti-headless/recipes-kernel/toolchain/kernel-toolchain-native_5.15.bb"
BBMASK += "meta-qti-bsp-prop/meta-qti-headless-prop/recipes-kernel/kernel-devicetree/kernel-devicetree.bb"

# Switch package format to rpm for GVM
PACKAGE_CLASSES = "package_rpm"

# Mesa/virgl for virtio-gpu
# No physical Adreno GPU on this virtio VM target — use Mesa's virgl Gallium
# driver over virtio-gpu instead of the proprietary adreno/gbm recipes.
DISTRO_FEATURES:append = " opengl wayland"

PREFERRED_PROVIDER_virtual/egl         = "mesa"
PREFERRED_PROVIDER_virtual/libgles1    = "mesa"
PREFERRED_PROVIDER_virtual/libgles2    = "mesa"
PREFERRED_PROVIDER_virtual/libgbm      = "mesa"
PREFERRED_PROVIDER_virtual/wayland-egl = "mesa"

VIRTUAL-RUNTIME_egl         = "mesa"
VIRTUAL-RUNTIME_libgles1    = "mesa"
VIRTUAL-RUNTIME_libgles2    = "mesa"
VIRTUAL-RUNTIME_wayland-egl = "mesa"

BB_MULTI_PROVIDER_ALLOWED += "virtual/wayland-egl virtual/egl virtual/libgles1 virtual/libgles2 virtual/libgbm"

PREFERRED_VERSION_wayland-protocols = "1.49"
PREFERRED_VERSION_mesa              = "26.0.0"
```

## meta-qti-distro/conf/distro/auto-gvm.conf
```bitbake
require conf/distro/include/auto-common.inc

DISTRO_NAME = "auto gvm"

DISTRO_FEATURES:append = " \
    qti-adsp \
    qti-audio \
    qti-audio-ar \
    qti-audio-awe \
    qti-camera \
    qti-cdsp \
    qti-cdsp1 \
    qti-core \
    qti-data \
    qti-display \
    qti-extra \
    qti-graphics \
    qti-multimedia \
    qti-security \
    qti-vnw \
    qti-tools \
    qti-avb \
    qti-fde \
    qti-fastcv \
    ab-boot-support \
"

DISTRO_FEATURES:remove:quin-gvm-gen4-2 = "\
    qti-audio \
"

DISTRO_FEATURES:remove:qtiquingvm8295 = "\
    qti-audio-ar \
"

DISTRO_FEATURES:remove:quin-gvm-lemans = "\
    qti-audio \
"
DISTRO_FEATURES:remove:gh-gvm-lemans = "\
    qti-audio \
    qti-audio-ar \
    qti-multimedia \
    qti-display \
    qti-camera \
    qti-avb \
"

DISTRO_FEATURES:remove:gvm-gen5 = "\
    qti-audio \
    qti-audio-ar \
    qti-multimedia \
"

DISTRO_FEATURES:remove:quin-gvm-monaco = "\
    qti-audio \
    qti-vnw \
    qti-fastcv \
"

DISTRO_FEATURES:remove:quin-gvm-gen4-5 = "\
    qti-audio \
"

DISTRO_FEATURES:remove:gvm-gen4-5 = "\
    qti-audio \
"

DISTRO_FEATURES:remove:quin-gvm-gen4-2 = "wifi"
DISTRO_FEATURES:remove:quin-gvm-lemans = "wifi"
DISTRO_FEATURES:remove:gh-gvm-lemans = "wifi"
DISTRO_FEATURES:remove:qtiquingvm8295 = "wifi"
DISTRO_FEATURES:remove:quin-gvm-gen4 = "wifi"
DISTRO_FEATURES:remove:quin-gvm-monaco = "wifi"
DISTRO_FEATURES:remove:quin-gvm-gen4-5 = "wifi"
DISTRO_FEATURES:remove:gvm-gen4-5 = "wifi"

# Switch package format to rpm for GVM
PACKAGE_CLASSES = "package_rpm"
```

## meta-qti-distro/conf/distro/auto.conf
```bitbake
require conf/distro/include/auto-common.inc

DISTRO_NAME = "auto"

DISTRO_FEATURES:append:sa81x5 = "${@bb.utils.contains_any('VARIANT', 'perf user', ' early_init', '', d)}"

DISTRO_FEATURES:append = " \
    qti-adsp \
    qti-audio \
    qti-bluetooth \
    qti-fastcv \
    qti-audio-ar \
    qti-camera \
    qti-cdsp \
    qti-core \
    qti-data \
    qti-display \
    qti-extra \
    qti-graphics \
    qti-ml \
    qti-multimedia \
    qti-security \
    qti-tools \
    qti-vnw \
    qti-location \
    qti-avb \
    ab-boot-support \
    qti-wlan \
    qti-compute-platform \
    qti-rideware \
"

DISTRO_FEATURES:remove = "\
    qti-location \
    early-eth \
"

DISTRO_FEATURES:remove:monaco = "\
    qti-ml \
    qti-audio \
    qti-fastcv \
    qti-camera \
    qti-lxc \
"

# Disable qti-avb on minimal as the feature not need
DISTRO_FEATURES:remove:pn-core-image-minimal = "qti-avb"

# Disable qti-avb on ubuntu as the feature not need
DISTRO_FEATURES:remove = "\
    ${@bb.utils.contains('TCMODE', 'external-ubuntu', 'qti-avb', '', d)} \
"

DISTRO_FEATURES:append:sa8650-adas = " \
    qti-fde \
"

DISTRO_FEATURES:append:sa8797 = " \
    qti-rumi \
    qti-audio-aw \
"

DISTRO_FEATURES:remove:sa8797 = " \
    qti-adsp \
    qti-audio \
    qti-audio-ar \
    qti-bluetooth \
    qti-fastcv \
    qti-camera \
    qti-cdsp \
    qti-display \
    qti-extra \
    qti-graphics \
    qti-ml \
    qti-vnw \
    qti-location \
    qti-avb \
    ab-boot-support \
    qti-wlan \
"
```
