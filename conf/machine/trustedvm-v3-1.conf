## conf/machine/trustedvm-v3-1.conf
```bitbake
# Copyright (c) Qualcomm Technologies, Inc. and/or its subsidiaries.
# SPDX-License-Identifier: BSD-3-Clause-Clear

#@TYPE: Machine
#@NAME: TRUSTEDVM-V3-1
#@DESCRIPTION: Machine configuration for MTP with TRUSTEDVM

BASEMACHINE = "trustedvm-v3-1"
require conf/machine/include/basemachine.inc

DEFAULTTUNE = "aarch64"
include conf/machine/include/arm/arch-armv8a.inc

PREFERRED_PROVIDER_virtual/mkbootimg = "mkbootimg-gki"
PREFERRED_PROVIDER_virtual/mkdtimg   = "mkdtimg-gki"
PREFERRED_PROVIDER_virtual/kernel   = "linux-msm"
#PREFERRED_PROVIDER_virtual/dtc-native = "dtc-android-build-native"
PREFERRED_VERSION_linux-msm = "${VM_KERNEL_VERSION}"
PREFERRED_VERSION_linux-msm-headers ?= "6.4"
PREFERRED_VERSION_kernel-toolchain ?= "${PREFERRED_VERSION_linux-msm}"
PREFERRED_VERSION_kernel-toolchain-native = "${PREFERRED_VERSION_linux-msm}"
PREFERRED_VERSION_dtc-android-build ?= "${PREFERRED_VERSION_linux-msm}"
PREFERRED_VERSION_mkbootimg-gki ?= "${PREFERRED_VERSION_linux-msm}"
PREFERRED_VERSION_coreutils ?= "6.9"
PREFERRED_PROVIDER_virtual/refpolicy = "refpolicy-mls-vm"

LLVM_VERSION = "8.0"

PAGE_SIZE ?= '4096'

EXTRA_IMAGECMD ?= "-N 2048"

KERNEL_IMAGETYPE = "Image"
KERNEL_CMD_PARAMS = ""
KERNEL_VARIANT = ""
KERNEL_VARIANT:qti-distro-base-debug = "debug_"
SERIAL_CONSOLE = "115200 hvc0"
VM_TARGET = "${VM_KERNEL_TARGET}"

MACHINE_USES_KERNEL_PREBUILTS = "True"
KERNEL_PLATFORM_PATH ?= "${WORKSPACE}/kernel-${PREFERRED_VERSION_linux-msm}/kernel_platform/"
KERNEL_PREBUILT_PATH ?= "${WORKSPACE}/kernel-${PREFERRED_VERSION_linux-msm}/out/msm-kernel-${VM_TARGET}_tuivm-${KERNEL_VARIANT}defconfig/"
KERNEL_PREBUILT_DISTDIR ?= "${WORKSPACE}/kernel-${PREFERRED_VERSION_linux-msm}/out/msm-kernel-${VM_TARGET}_tuivm-${KERNEL_VARIANT}defconfig/dist"
KERNEL_TYPE = "dist"
KERNEL_TOOLS_USES_MUSLC = "False"
LD_PATH_MUSLC = "${WORKSPACE}/kernel-${PREFERRED_VERSION_linux-msm}/kernel_platform/prebuilts/kernel-build-tools/linux_musl-x86/lib64/"
LD_PATH_GLIBC = "${WORKSPACE}/kernel-${PREFERRED_VERSION_linux-msm}/kernel_platform/prebuilts/kernel-build-tools/linux-x86/lib64/"

#### KERNEL ####
KERNEL_VARIANT:qti-distro-debug ?= "debug"
KERNEL_VARIANT:qti-distro-perf ?= ""
# Check for msm-kernel or gki_kernel
KERNEL_TYPE = "dist"

KERNEL_TOOLS_USES_MUSLC = "False"
LD_PATH_MUSLC = "${WORKSPACE}/kernel-${PREFERRED_VERSION_linux-msm}/kernel_platform/prebuilts/kernel-build-tools/linux_musl-x86/lib64/"
LD_PATH_GLIBC = "${WORKSPACE}/kernel-${PREFERRED_VERSION_linux-msm}/kernel_platform/prebuilts/kernel-build-tools/linux-x86/lib64/"


KERNEL_DEFCONFIG = "msm-kernel-kalama_le-${KERNEL_VARIANT}"
KERNEL_OUT_PATH = "${KERNEL_PREBUILT_PATH}"
KERNEL_BUILD_CONFIG = "msm-kernel/${KERNEL_CONFIG}"
ENABLE_DDK_BUILD="true"

#### dtb ####
KERNEL_CONFIG  ?= "build.config.msm.parrot.vm"
TARGET_BOARD_PLATFORM="parrot-vms"
KERNEL_DTB_NAMES = "parrot-vm-qrd-wcn6750.dtb parrot-vm-qrd.dtb parrot-vm-idp-wcn6750-amoled-rcm.dtb parrot-vm-idp-wcn6750-amoled.dtb parrot-vm-idp-wcn3990-amoled-rcm.dtb parrot-vm-idp-wcn3990.dtb  parrot-vm-rumi.dtb parrot-vm-atp.dtb parrot-vm-idp.dtb ravelin-vm-rumi.dtb ravelin-vm-atp.dtb ravelin-vm-idp.dtb ravelin-vm-idp-wcn3988.dtb ravelin-vm-idp-wcn3950-amoled-rcm.dtb ravelin-vm-qrd.dtb"

KP_STRIP_VERSION="11.5.0"

# filesystem configurations to be applied on image.
MACHINE_FSCONFIG_CONF = "trustedvm-fsconfig.conf"
MACHINE_SUPPORTS_USB = "False"
MACHINE_SUPPORTS_ANDROID_PROPERTIES = "False"
MACHINE_SUPPORTS_DISPLAY = "True"
MACHINE_SUPPORTS_MINK = "False"
MACHINE_SUPPORTS_SECUREMSM = "True"
MACHINE_SUPPORTS_TOUCH = "True"
MACHINE_SUPPORTS_OEMVM = "False"
MACHINE_MNT_POINTS = " "
ENABLE_ADB = "False"
# Formats of root filesystem images.
IMAGE_FSTYPES += "ext4"
IMAGE_INIT_MANAGER = "systemd"

VALG = 'False'

SYSTEMIMAGE_TARGET = "system.img"
VMUSERDATAIMAGE_TARGET = "vm-userdata.img"
VMIMAGE_TARGET = "vm-bootsys.img"
VMPERSIST_TARGET = "vm-persist.img"
DTB_TARGET = "vm.dtb"
KERNEL_OFFSET_TRUSTEDVM = "0xE0C00000"
DTB_OFFSET_TRUSTEDVM = "0xE2C00000"
RAMDISK_OFFSET_TRUSTEDVM = "0xE2F00000"
CMDLINE_OFFSET_TRUSTEDVM = "0xE2F00000"
# ZRAM
SWAP_MEMTOTAL_PCT = "200"

KERNEL_OFFSET_OEMVM = "0x0"
DTB_OFFSET_OEMVM = "0x2000000"
RAMDISK_OFFSET_OEMVM = "0x2100000"
CMDLINE_OFFSET_OEMVM = "0x2100000"

# Ramdisk size is 8 MB
RAMDISK_SIZE = "10388608"

SYSTEM_SIZE_EXT4 ?= "258000000"
USERDATA_SIZE_EXT4 ?= "25000000"
PERSIST_IMAGE_ROOTFS_SIZE = "119000000"
PERSIST_OEMVM_IMAGE_ROOTFS_SIZE = "70000000"
PERSIST_SIZE_EXT4 = "119000000"
VM_PERSIST_SIZE_EXT4 ?= "220000000"
VM_SIZE_EXT4 ?= "562000000"

MACHINE_FEATURES:append = " qti-multivm dm-verity-cpio-cmdline qti-vm qti-vm-tui qti-vm-persist qti-vm-target qti-vm-tui-legacy qti-disable-csf"

PREFERRED_PROVIDER_virtual/base-utils = "toybox"
VIRTUAL-RUNTIME_base-utils = "toybox"
#VIRTUAL-RUNTIME_base-utils-hwclock = ""
#VIRTUAL-RUNTIME_base-utils-syslog = ""
#VIRTUAL-RUNTIME_login_manager = ""
INIT_MANAGER = "systemd"
TOYBOX_RAMDISK = "True"

# On msm-5.4 or above ufs driver supports BSG Device.
UFS_BSG_DEV_USAGE = "True"

MACHINE_FEATURES += " gh-loader "
MACHINE_FEATURES += " dummy-image "
```

## conf/machine/trustedvm-v3.conf
```bitbake
#@TYPE: Machine
#@NAME: TRUSTEDVM-V3
#@DESCRIPTION: Machine configuration for QTI MTP with TRUSTEDVM

BASEMACHINE = "trustedvm-v3"
require conf/machine/include/basemachine.inc

DEFAULTTUNE = "aarch64"
include conf/machine/include/arm/arch-armv8a.inc

PREFERRED_PROVIDER_virtual/mkbootimg = "mkbootimg-gki"
PREFERRED_PROVIDER_virtual/mkdtimg   = "mkdtimg-gki"
PREFERRED_PROVIDER_virtual/kernel   = "${PREFERREDPROVIDER_KERNEL}"
#PREFERRED_PROVIDER_virtual/dtc-native = "dtc-android-build-native"
PREFERRED_VERSION_displaydlkm = "${DISPLAY_DRIVERS_VERSION}"
PREFERRED_VERSION_touchdlkm = "${TOUCH_DRIVERS_VERSION}"
PREFERRED_VERSION_sat-module = "${SATMODULEVERSION}"
PREFERRED_VERSION_linux-msm = "${VM_KERNEL_VERSION}"
PREFERRED_VERSION_linux-msm-headers ?= "${KERNELHEADERSVERSION}"
PREFERRED_VERSION_kernel-toolchain ?= "${PREFERRED_VERSION_linux-msm}"
PREFERRED_VERSION_kernel-toolchain-native = "${PREFERRED_VERSION_linux-msm}"
PREFERRED_VERSION_dtc-android-build ?= "${PREFERRED_VERSION_linux-msm}"
PREFERRED_VERSION_mkbootimg-gki ?= "${PREFERRED_VERSION_linux-msm}"
PREFERRED_VERSION_coreutils ?= "6.9"
PREFERRED_PROVIDER_virtual/refpolicy = "refpolicy-mls-vm"

LLVM_VERSION = "8.0"

PAGE_SIZE ?= '4096'

EXTRA_IMAGECMD ?= "-N 2048"

KERNEL_IMAGETYPE = "Image"
KERNEL_CMD_PARAMS = ""
KERNEL_VARIANT = ""
KERNEL_VARIANT:qti-distro-base-debug = "debug_"
SERIAL_CONSOLE = "115200 hvc0"
VM_TARGET = "${VM_KERNEL_TARGET}"

MACHINE_USES_KERNEL_PREBUILTS = "True"
KERNEL_PLATFORM_PATH ?= "${WORKSPACE}/kernel-${PREFERRED_VERSION_linux-msm}/kernel_platform/"
KERNEL_PREBUILT_PATH ?= "${WORKSPACE}/kernel-${PREFERRED_VERSION_linux-msm}/out/msm-kernel-${VM_TARGET}_vms-${KERNEL_VARIANT}defconfig/"
KERNEL_PREBUILT_DISTDIR ?= "${WORKSPACE}/kernel-${PREFERRED_VERSION_linux-msm}/out/msm-kernel-${VM_TARGET}_vms-${KERNEL_VARIANT}defconfig/dist"
KERNEL_TYPE = "dist"
KERNEL_TOOLS_USES_MUSLC = "${KERNEL_USE_MUSLC}"
LD_PATH_GLIBC = "${WORKSPACE}/kernel-${PREFERRED_VERSION_linux-msm}/kernel_platform/prebuilts/kernel-build-tools/linux-x86/lib64/"
LD_PATH_MUSLC = "${WORKSPACE}/kernel-${PREFERRED_VERSION_linux-msm}/kernel_platform/prebuilts/kernel-build-tools/linux_musl-x86/lib64/"

#### KERNEL ####
KERNEL_VARIANT:qti-distro-debug ?= "debug"
KERNEL_VARIANT:qti-distro-perf ?= ""
# Check for msm-kernel or gki_kernel
KERNEL_TYPE = "dist"


KERNEL_DEFCONFIG = "msm-kernel-kalama_le-${KERNEL_VARIANT}"
KERNEL_OUT_PATH = "${KERNEL_PREBUILT_PATH}"
KERNEL_CONFIG  ?= "build.config.msm.sun.vm"
KERNEL_BUILD_CONFIG = "${KERNELBUILD}/${KERNEL_CONFIG}"
TARGET_BOARD_PLATFORM="${TARGETBOARDPLATFORM}"
DDK_BUILD="${DDKBUILD}"
CLANG_VERSION="${CLANGVERSION}"
KP_STRIP_VERSION = "${KPSTRIPVERSION}"

KERNEL_DEFCONFIG_VARIANT = "defconfig"
#KERNEL_DEFCONFIG_VARIANT:qti-distro-base-debug = "debug-defconfig"
KERNEL_HEADERS_VARIANT:qti-distro-base-debug = "debug-"
KERNEL_IS_SOC_REPO = "True"
KERNEL_DEFCONFIG_VARIANT:qti-distro-base-debug = "${@'debug-defconfig' if d.getVar('KERNELBUILD') == 'soc-repo' else 'debug_defconfig'}"
KERNEL_IS_SOC_REPO = "${@'True' if d.getVar('KERNELBUILD') == 'soc-repo' else 'False'}"

#### dtb ####
KERNEL_DTB_NAMES = "${KERNELDTBNAMES}"

# filesystem configurations to be applied on image.
MACHINE_FSCONFIG_CONF = "trustedvm-fsconfig.conf"
MACHINE_SUPPORTS_USB = "False"
MACHINE_SUPPORTS_ANDROID_PROPERTIES = "False"
MACHINE_SUPPORTS_DISPLAY = "True"
MACHINE_SUPPORTS_MINK = "True"
MACHINE_SUPPORTS_SECUREMSM = "True"
MACHINE_SUPPORTS_TOUCH = "True"
MACHINE_SUPPORTS_OEMVM = "True"
MACHINE_MNT_POINTS = " "
ENABLE_ADB = "False"
# Formats of root filesystem images.
IMAGE_FSTYPES += "ext4"
IMAGE_INIT_MANAGER = "systemd"

VALG = 'False'

SYSTEMIMAGE_TARGET = "system.img"
VMUSERDATAIMAGE_TARGET = "vm-userdata.img"
VMIMAGE_TARGET = "vm-bootsys.img"
VMPERSIST_TARGET = "vm-persist.img"
DTB_TARGET = "vm.dtb"
KERNEL_OFFSET_TRUSTEDVM = "0x0"
DTB_OFFSET_TRUSTEDVM = "0x2000000"
RAMDISK_OFFSET_TRUSTEDVM = "0x2400000"
CMDLINE_OFFSET_TRUSTEDVM = "0x2400000"

KERNEL_OFFSET_OEMVM = "0x0"
DTB_OFFSET_OEMVM = "0x2000000"
RAMDISK_OFFSET_OEMVM = "0x2100000"
CMDLINE_OFFSET_OEMVM = "0x2100000"

# Ramdisk size is 8 MB
RAMDISK_SIZE = "10388608"

SYSTEM_SIZE_EXT4 ?= "${@'245000000' if d.getVar('KERNEL_IS_SOC_REPO') == 'True' else '258000000'}"
USERDATA_SIZE_EXT4 ?= "25000000"
PERSIST_IMAGE_ROOTFS_SIZE = "194000000"
PERSIST_OEMVM_IMAGE_ROOTFS_SIZE = "5000000"
PERSIST_SIZE_EXT4 = "194000000"
VM_PERSIST_SIZE_EXT4 ?= "220000000"
VM_SIZE_EXT4 ?= "562000000"

MACHINE_FEATURES:append = " qti-multivm qti-vm qti-vm-tui qti-vm-persist qti-smmu-proxy vm-dynamic-memresize qti-vm-target qti-vm-mink qti-vm-ipp qti-vm-c2pa "
MACHINE_FEATURES:append = "${@' dm-verity-initramfs ' if d.getVar('KERNEL_IS_SOC_REPO') == 'True' else 'dm-verity-cpio-cmdline'}"

PREFERRED_PROVIDER_virtual/base-utils = "toybox"
VIRTUAL-RUNTIME_base-utils = "toybox"
#VIRTUAL-RUNTIME_base-utils-hwclock = ""
VIRTUAL-RUNTIME_base-utils-syslog = ""
#VIRTUAL-RUNTIME_login_manager = ""
INIT_MANAGER = "systemd"
TOYBOX_RAMDISK = "True"

# On msm-5.4 or above ufs driver supports BSG Device.
UFS_BSG_DEV_USAGE = "True"

MACHINE_FEATURES += " gh-loader "

# ZRAM
SWAP_MEMTOTAL_PCT = "0"
```

## conf/machine/trustedvm-v5.conf
```bitbake
#@TYPE: Machine
#@NAME: TRUSTEDVM-V4
#@DESCRIPTION: Machine configuration for QTI MTP with TRUSTEDVM

BASEMACHINE = "trustedvm-v5"
require conf/machine/include/basemachine.inc

DEFAULTTUNE = "aarch64"
include conf/machine/include/arm/arch-armv8a.inc

PREFERRED_PROVIDER_virtual/mkbootimg = "mkbootimg-kp"
PREFERRED_PROVIDER_virtual/mkbootimg-native = "mkbootimg-kp-native"
PREFERRED_PROVIDER_virtual/mkdtimg   = "mkdtimg-gki"
PREFERRED_PROVIDER_virtual/kernel   = "linux-soc-repo"
#PREFERRED_PROVIDER_virtual/dtc-native = "dtc-android-build-native"
PREFERRED_VERSION_touchdlkm = "2.0"
PREFERRED_VERSION_displaydlkm = "2.0"
PREFERRED_VERSION_linux-msm = "${VM_KERNEL_VERSION}"
PREFERRED_VERSION_linux-msm-headers = "6.11"
PREFERRED_VERSION_kernel-toolchain ?= "${PREFERRED_VERSION_linux-msm}"
PREFERRED_VERSION_kernel-toolchain-native = "${PREFERRED_VERSION_linux-msm}"
PREFERRED_VERSION_dtc-android-build ?= "${PREFERRED_VERSION_linux-msm}"
PREFERRED_VERSION_mkbootimg-gki ?= "${PREFERRED_VERSION_linux-msm}"
PREFERRED_PROVIDER_virtual/refpolicy = "refpolicy-mls-vm"
HOSTTOOLS += "rsync nproc lex"

PAGE_SIZE ?= '4096'

EXTRA_IMAGECMD ?= "-N 2048"

KERNEL_IMAGETYPE = "Image"
KERNEL_CMD_PARAMS = ""
KERNEL_VARIANT = ""
KERNEL_VARIANT:qti-distro-base-debug = "debug_"
KERNEL_DEFCONFIG_VARIANT = "defconfig"
KERNEL_DEFCONFIG_VARIANT:qti-distro-base-debug = "debug-defconfig"
KERNEL_HEADERS_VARIANT:qti-distro-base-debug = "debug-"
SERIAL_CONSOLE = "115200 hvc0"

MACHINE_USES_KERNEL_PREBUILTS = "True"
KERNEL_PLATFORM_PATH ?= "${WORKSPACE}/kernel-${PREFERRED_VERSION_linux-msm}/kernel_platform/"
KERNEL_PREBUILT_PATH ?= "${WORKSPACE}/kernel-${PREFERRED_VERSION_linux-msm}/out/msm-kernel-${VM_TARGET}_vms-${KERNEL_VARIANT}defconfig/"
KERNEL_PREBUILT_DISTDIR ?= "${WORKSPACE}/kernel-${PREFERRED_VERSION_linux-msm}/out/msm-kernel-${VM_TARGET}_vms-${KERNEL_VARIANT}defconfig/dist"
KERNEL_TYPE = "dist"
TARGET_BOARD_PLATFORM="${VM_KERNEL_TARGET}-tuivm"
DDK_BUILD="true"
GCCVERSION:forcevariable = "13.3%"
KP_STRIP_VERSION="${GCCVERSION}"
CLANG_VERSION="r584948c"

KERNEL_TOOLS_USES_MUSLC = "True"
LD_PATH_MUSLC = "${WORKSPACE}/kernel-${PREFERRED_VERSION_linux-msm}/kernel_platform/prebuilts/kernel-build-tools/linux_musl-x86/lib64/"
LD_PATH_GLIBC = "${WORKSPACE}/kernel-${PREFERRED_VERSION_linux-msm}/kernel_platform/prebuilts/kernel-build-tools/linux-x86/lib64/"

#### KERNEL ####
KERNEL_VARIANT:qti-distro-debug ?= "debug"
KERNEL_VARIANT:qti-distro-perf ?= ""
# Check for soc-repo or gki_kernel
KERNEL_TYPE = "dist"


KERNEL_OUT_PATH = "${KERNEL_PREBUILT_PATH}"
KERNEL_CONFIG  ?= "build.config.msm.${VM_TARGET}.vm"
KERNEL_BUILD_CONFIG = "soc-repo/${KERNEL_CONFIG}"
KERNEL_IS_SOC_REPO ="True"

#### dtb ####
KERNEL_DTB_NAMES = "art-vm-*.dtb art-oemvm-*.dtb"


# filesystem configurations to be applied on image.
MACHINE_FSCONFIG_CONF = "trustedvm-fsconfig.conf"
MACHINE_SUPPORTS_USB = "False"
MACHINE_SUPPORTS_ANDROID_PROPERTIES = "False"
MACHINE_SUPPORTS_DISPLAY = "True"
MACHINE_SUPPORTS_MINK = "True"
MACHINE_SUPPORTS_SECUREMSM = "True"
MACHINE_SUPPORTS_TOUCH = "True"
MACHINE_SUPPORTS_OEMVM = "True"
MACHINE_MNT_POINTS = " "
ENABLE_ADB = "False"
# Formats of root filesystem images.
IMAGE_FSTYPES += "ext4"
IMAGE_INIT_MANAGER = "systemd"

VALG = 'False'

SYSTEMIMAGE_TARGET = "system.img"
VMUSERDATAIMAGE_TARGET = "vm-userdata.img"
VMIMAGE_TARGET = "vm-bootsys.img"
VMPERSIST_TARGET = "vm-persist.img"
DTB_TARGET = "vm.dtb"
KERNEL_OFFSET_TRUSTEDVM = "0x200000"
DTB_OFFSET_TRUSTEDVM = "0x2000000"
BASE_DTB_OFFSET_TRUSTEDVM = "0x2700000"
RAMDISK_OFFSET_TRUSTEDVM = "0x2800000"
CMDLINE_OFFSET_TRUSTEDVM = "0x2800000"
VMDATA_OFFSET_TRUSTEDVM = "0x3800000"

KERNEL_OFFSET_OEMVM = "0x200000"
DTB_OFFSET_OEMVM = "0x2000000"
BASE_DTB_OFFSET_OEMVM = "0x2700000"
RAMDISK_OFFSET_OEMVM = "0x2800000"
CMDLINE_OFFSET_OEMVM = "0x2800000"
VMDATA_OFFSET_OEMVM = "0x3800000"

# Ramdisk size is 8 MB
RAMDISK_SIZE = "10388608"

SYSTEM_SIZE_EXT4 ?= "230000000"
USERDATA_SIZE_EXT4 ?= "25000000"
PERSIST_IMAGE_ROOTFS_SIZE = "194000000"
PERSIST_OEMVM_IMAGE_ROOTFS_SIZE = "5000000"
PERSIST_SIZE_EXT4 = "194000000"
VM_PERSIST_SIZE_EXT4 ?= "220000000"
VM_SIZE_EXT4 ?= "562000000"

MACHINE_FEATURES:append = " qti-multivm dm-verity-initramfs qti-vm qti-vm-tui qti-smmu-proxy qti-vm-persist vm-dynamic-memresize qti-vm-target qti-vm-mink qti-vm-ipp qti-vm-c2pa qti-avf qti-vm-idv "

PREFERRED_PROVIDER_virtual/base-utils = "toybox"
VIRTUAL-RUNTIME_base-utils = "toybox"
#VIRTUAL-RUNTIME_base-utils-hwclock = ""
VIRTUAL-RUNTIME_base-utils-syslog = ""
#VIRTUAL-RUNTIME_login_manager = ""
INIT_MANAGER = "systemd"
TOYBOX_RAMDISK = "True"

# On msm-5.4 or above ufs driver supports BSG Device.
UFS_BSG_DEV_USAGE = "True"

MACHINE_FEATURES += " gh-loader "

# ZRAM
SWAP_MEMTOTAL_PCT = "200"

DISTRO_FEATURES:append  = " selinux"
DISTRO_FEATURES_FILTER_NATIVE += " selinux "
INHERIT:remove = "rm_work"
```
