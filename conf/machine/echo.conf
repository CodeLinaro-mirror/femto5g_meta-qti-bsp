## conf/machine/echo.conf
```bitbake
#@TYPE: Machine
#@NAME: ECHO
#@DESCRIPTION: Machine configuration for Amboseli-RDKB
require ${COREBASE}/meta-qti-bsp/conf/machine/echo-base.conf

DISTRO_FEATURES += "dm-verity"

# When dm-verity is enabled: remove the no-verity placeholder and add v4 initramfs support.
MACHINE_FEATURES:remove = "${@bb.utils.contains('DISTRO_FEATURES', 'dm-verity', 'dm-verity-none', '', d)}"
MACHINE_FEATURES:append = "${@bb.utils.contains('DISTRO_FEATURES', 'dm-verity', ' dm-verity-initramfs-v4', '', d)}"
KERNEL_CMD_PARAMS:append = "${@bb.utils.contains('DISTRO_FEATURES', 'dm-verity', ' verity=enabled', '', d)}"

KERNEL_CONFIG_FRAGMENTS:append = " \
    ${S}/arch/arm64/configs/vendor/echo-mbb.config \
    ${S}/arch/arm64/configs/vendor/echo-cpe.config \
    ${S}/arch/arm64/configs/vendor/echo-rdkb.config \
    ${S}/arch/arm64/configs/vendor/echo-cpe-plus.config \
    ${S}/arch/arm64/configs/vendor/echo-mbb-plus.config \
    ${S}/arch/arm64/configs/vendor/echo-rdkb-plus.config"
KERNEL_CONFIG_FRAGMENTS:append = " ${@oe.utils.vartrue('DEBUG_BUILD', '${S}/arch/arm64/configs/vendor/echo-debug.config ${S}/arch/arm64/configs/vendor/echo-plus-debug.config', '', d)}"
```
