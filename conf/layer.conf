## conf/machine/sdxlemur.conf
```bitbake
#@TYPE: Machine
#@NAME: SDXLEMUR with 6.18 kernel
#@DESCRIPTION: Machine configuration for QTI MTP with SDXLEMUR
BASEMACHINE ?= "sdxlemur"
require conf/machine/include/basemachine.inc

SOC_FAMILY ?= "mdm9x50"

DEFAULTTUNE ?= "armv7athf-neon"
include conf/machine/include/arm/arch-armv7a.inc

PREFERRED_PROVIDER_virtual/kernel = "linux-msm-src"
PREFERRED_PROVIDER_linux-msm-headers = "linux-kernel-qcom-headers"
PREFERRED_PROVIDER_virtual/mkbootimg = "mkbootimg"
PREFERRED_PROVIDER_virtual/mkbootimg-native = "mkbootimg-native"
PREFERRED_VERSION_mkbootimg = "2.0"
PREFERRED_VERSION_mkbootimg-native = "2.0"
PREFERRED_PROVIDER_virtual/mkdtimg   = "mkdtimg-gki"
#PREFERRED_PROVIDER_virtual/dtc-native = "dtc-android-build-native"
PREFERRED_VERSION_linux-msm ?= "6.18"
PREFERRED_VERSION_linux-msm-headers ?= "6.18"
#PREFERRED_VERSION_kernel-toolchain ?= "6.18"
#PREFERRED_VERSION_dtc-android-build ?= "6.18"
#PREFERRED_VERSION_mkbootimg-gki ?= "6.18"
#PREFERRED_VERSION_mkbootimg-gki-native = "6.18"
#PREFERRED_VERSION_mod-signing-keys ?= "6.18"
#PREFERRED_VERSION_merge-dtbs-gki-native = "6.18"
#PREFERRED_VERSION_gki-kernel-modules = "6.18"
#PREFERRED_VERSION:securemsmdlkm ?= "1.0"
PREFERRED_PROVIDER_virtual/refpolicy  = "refpolicy-mls"
PREFERRED_VERSION_refpolicy-mls = "git"
### KERNEL ####
MACHINE_USES_KERNEL_PREBUILTS = "False"
KERNEL_VARIANT = ""
KERNEL_VARIANT:qti-distro-nosecurity-debug = "debug_"
KERNEL_VARIANT:qti-distro-nosecurity-perf = "perf_"
KERNEL_VARIANT:qti-distro-nosecurity-user = "user_"
KERNEL_VARIANT:qti-distro-base-debug = "debug_"
KERNEL_VARIANT:qti-distro-base-perf = "perf_"
KERNEL_VARIANT:qti-distro-base-user = "user_"
#INITRAMFS_IMAGE = "qti-ramdisk-image"
#INITRAMFS_FSTYPES = "cpio.lz4"
#VENDOR_INITRAMFS_IMAGE = "qti-vendor-ramdisk-image"

#KERNEL_CONF ?= "qcom_base_defconfig"
#KERNEL_DEFCONFIG = "sdxlemur${KERNEL_VARIANT}"
KERNEL_DEFCONFIG = "generic_mbb_defconfig"
KERNEL_CONFIG = "generic_mbb_defconfig"

#Various kernel directories
KERNEL_PLATFORM_PATH = "${WORKSPACE}/kernel-6.18/kernel_platform"
# With bazel
KERNEL_PREBUILT_PATH = "${KERNEL_PLATFORM_PATH}/out/msm-kernel-${KERNEL_DEFCONFIG}"
KERNEL_PREBUILT_DISTDIR = "${KERNEL_PREBUILT_PATH}/dist"
KERNEL_TYPE = "dist"

KERNEL_OUT_PATH = "${KERNEL_PREBUILT_PATH}"

# Set sectool5 as preffered provider for signing

ENABLE_SIGNED_IMAGES = "1"
PREFERRED_PROVIDER_virtual/signtools-native = "sectool5-native"
SECTOOLS_PY_DIR = "${KERNEL_PLATFORM_PATH}/prebuilts/qcom_boot_artifacts/sectools/sectoolsv1"
#KERNEL_CONFIG ?= "vendor/sdxlemur_defconfig"
#KERNEL_CONFIG_qti-distro-debug ?= "vendor/sdxlemur-debug_defconfig"
ENABLE_DDK_BUILD="true"
TARGET_BOARD_PLATFORM="sdxlemur"

#### DTB ####
KERNEL_DTB_NAMES = "sdxlemur-mtp.dtb \
                    sdxlemur-mtp-mbb.dtb \
                    sdxlemur-v2-mtp-mbb.dtb \
		    "
MACHINE_SUPPORTS_DTBO = "False"
BUILD_WITH_TECHPACKS = "0"
SKIP_VENDOR_BOOT = "True"

#### boot.img ####
LLVM_VERSION = "14.0"
KERNEL_IMAGETYPE = "zImage"
KERNEL_BASE = "0x80000000"
KERNEL_TAGS_OFFSET = "0x82000000"

#### cmdline ####
# need seperaton later for debug and release build
#CONSOLE_PARAM:qti-distro-perf  = "console=ttyMSM0,115200n8"
#CONSOLE_PARAM:qti-distro-debug = "ro rootwait console=ttyMSM0,115200,n8 androidboot.hardware=qcom msm_rtb.filter=0x237 androidboot.console=ttyMSM0 lpm_levels.sleep_disabled=1 firmware_class.path=/lib/firmware/updates,/firmware/image service_locator.enable=1 net.ifnames=0 atlantic_fwd.rx_ring_size=512 atlantic_fwd.rx_linear=1 pcie_ports=compat pci=pcie_bus_safe qcom_scm.download_mode=1"
#KERNEL_CMD_PARAMS = "${CONSOLE_PARAM}"

KERNEL_CMD_PARAMS = " ro rootwait earlycon=msm_serial_dm,0x831000  console=ttyMSM0,115200,n8 androidboot.hardware=qcom msm_rtb.filter=0x237 \
 androidboot.console=ttyMSM0  lpm_levels.sleep_disabled=1 firmware_class.path=/lib/firmware/updates service_locator.enable=1 \
 net.ifnames=0 atlantic_fwd.rx_ring_size=512 atlantic_fwd.rx_linear=1 pcie_ports=compat pci=pcie_bus_perf vmalloc=512M \
 "
#### systemd ####
SERIAL_CONSOLES ?= "115200;ttyMSM0"
#### others ####
PAGE_SIZE ?= '4096'

#Abl would be enabled later
#EXTRA_IMAGEDEPENDS += "edk2"
#PREFERRED_VERSION_edk2 ?= "1.0"
ENABLE_SIGNED_IMAGES = "1"
# Will enabled DM-verity later
# DISTRO_FEATURES += "dm-verity"

# TODO: Temporary change to override BB_SIGNATURE_HANDLER set in local.conf.
# Other machines are already supporting OEEquivHash as hashing signature.
# Fix build issues observed in this machine and remove this override.
#BB_SIGNATURE_HANDLER = "OEBasicHash"

#QSEEComCompat and QSEECom are mutually exlusive and QSEEComCompat depends on  smcinvoke
#lv-build builds the required listernes , le_qseecom enables qseecomd
# qti-location:           Machine supports Location solution
MACHINE_FEATURES += "nand-boot dm-verity-none"
# qti-sdx qti-modem qti-qseecom qti-tzlog qti-crypto

##############################################################

# SElinux enablement in enforcing mode

#############################################################
# DEFAULT_ENFORCING = "permissive"

MACHINE_MNT_POINTS = " \
    /firmware \
    /persist \
    /cache \
    /data \
    /systemrw \
"

PAGE_SIZE ?= '4096'
UBINIZE_ARGS ?= "-m 4096 -p 256KiB -s 4096"
MKUBIFS_ARGS ?= "-m 4096 -e 253952 -c 2146 -F"
#MKUBIFS_USRFS_ARGS ?= "-m 4096 -e 253952 -c 2146 -F"
# Sysfs ubi volume sizes
SYSTEM_VOLUME_SIZE ?= "110MiB"
# rootfs volume size for 1GB storage
SYSTEM_VOLUME_SIZE_G ?= "214MiB"
CACHE_VOLUME_SIZE ?= "15MiB"
SYSTEMRW_VOLUME_SIZE ?= "6MiB"
PERSIST_VOLUME_SIZE ?= "6MiB"
SYSTEM_SIZE_EXT4   ?= "295MiB"
NVRAM_SIZE_EXT4   ?= "52428800"
USERDATA_SIZE ?= "2GiB"
CACHE_SIZE_EXT4 ?= "50MiB"
PERSIST_SIZE_EXT4 ?= "8192KB"
# Sign abl and boot images
ENABLE_SIGNED_IMAGES = "1"
BL_PLATFORM     = "sdxlemur"
SOC_VERSION     = "0x6016"
SOC_HW_VERSION  = "0x60160100"
SIGNING_VERSION = "_eccv3"
#SIGNING_FUNCTION = "sectoolv2_sign_abl"

SDCARD_DEVICE = ""

# Formats of root filesystem images
IMAGE_FSTYPES += "ubi ext4"

MACHINE_SUPPORTS_PDMAPPER = "False"
MACHINE_SUPPORTS_ANDROID_PROPERTIES = "False"
# Subsystem Ramdump support
MACHINE_SUPPORTS_SSR = "True"

MACHINE_FSCONFIG_CONF = "sdxlemur-fsconfig.conf"
#MACHINE_UBIFS_FSCONFIG_CONF = "sdxpinn-ubi-fsconfig.conf"

USBCOMPOSITION = "4EE7"

RAMDISK_TMPFS = "False"
#MACHINE_SUPPORTS_INIT_RAMDISK = "False"
#MACHINE_SUPPORTS_ADB_OVER_PCIE = "False"
#MACHINE_SUPPORTS_DIAG_OVER_PCIE = "False"

# Partition conf
#MACHINE_PARTITION_CONF = "echo-partition.conf"

# File indicating firmware residing places on device.
MACHINE_FILESMAP_CONF = "sdxlemur-filesmap"
MACHINE_FILESMAP_CONF_EMMC = "sdxlemur-emmc-filesmap"

# On msm-5.4 or above ufs driver supports BSG Device.
UFS_BSG_DEV_USAGE = "True"
CORE_IMAGE_EXTRA_INSTALL:remove = "packagegroup-qti-securemsm"
CORE_IMAGE_EXTRA_INSTALL:remove = "packagegroup-qti-qcc-prop"
# remove some of the component from debug tools.
RDEPENDS:packagegroup-qti-debug-tools:remove = "perf"
RDEPENDS:packagegroup-qti-debug-tools:remove = "valgrind"
IMAGE_FEATURES:remove = "nand2x"
IMAGE_FEATURES:remove = "persist-volume"

#GPLV3 exceptions
INCOMPATIBLE_LICENSE_EXCEPTIONS += 'bash:GPL-3.0-or-later'
INCOMPATIBLE_LICENSE_EXCEPTIONS += 'coreutils:GPL-3.0-or-later'
#Removing dependecncy on gdbserver
RDEPENDS:packagegroup-qti-debug-tools:remove = "gdbserver"
#INCOMPATIBLE_LICENSE_EXCEPTIONS += "  gdbserver:GPL-3.0-only \
#                                      gdbserver:LGPL-3.0-only \
#                                      gdb:GPL-3.0-only \  
#                                      gdb:LGPL-3.0-only \
#                                      gdbm:GPL-3.0-only \
#                                      readline:GPL-3.0-or-later\
#                                      mpfr:LGPL-3.0-or-later"
RRECOMMENDS:${PN}-container:remove:sdxlemur = "tar"
# Remove gdbm support from Python3
#INCOMPATIBLE_LICENSE_EXCEPTIONS += 'gdbm:GPL-3.0-only'
PACKAGECONFIG:remove:pn-python3 = "gdbm"
# Remove gdbm support from Perl
PACKAGECONFIG:remove:pn-perl = "gdbm"
# Remove gdbm support from apr-util (if used)
PACKAGECONFIG:remove:pn-apr-util = "gdbm"
#RDEPENDS:packagegroup-qti-securemsm:remove:sdxlemur = "trustedui-noship trustedui securemsm-internal"
RDEPENDS:packagegroup-qti-securemsm:remove = "securemsmdlkm"
IMAGE_INSTALL:remove = "opkg-utils"

DISTRO_FEATURES:remove = "selinux"
GENERATE_AB_OTA_PACKAGE = "0"
```

## conf/machine/trustedvm-v2-1.conf
```bitbake
#@TYPE: Machine
#@NAME: TRUSTEDVM-V2-1
#@DESCRIPTION: Machine configuration for QTI MTP with TRUSTEDVM

BASEMACHINE = "trustedvm-v2-1"
require conf/machine/include/basemachine.inc

DEFAULTTUNE = "aarch64"
include conf/machine/include/arm/arch-armv8a.inc

PREFERRED_PROVIDER_virtual/kernel = "linux-msm"
PREFERRED_VERSION_linux-msm = "${VM_KERNEL_VERSION}"
PREFERRED_VERSION_linux-msm-headers ?= "${PREFERRED_VERSION_linux-msm}"
PREFERRED_VERSION_kernel-toolchain ?= "${PREFERRED_VERSION_linux-msm}"
PREFERRED_VERSION_kernel-toolchain-native = "${PREFERRED_VERSION_linux-msm}"
PREFERRED_PROVIDER_virtual/refpolicy = "refpolicy-mls-vm"

LLVM_VERSION = "8.0"

PAGE_SIZE ?= '4096'

EXTRA_IMAGECMD ?= "-N 2048"

KERNEL_IMAGETYPE = "Image"
KERNEL_CMD_PARAMS = ""
KERNEL_VARIANT = ""
KERNEL_VARIANT:qti-distro-base-debug = "debug_"
SERIAL_CONSOLE = "115200 hvc0"
VM_TARGET = "${VM_KERNEL_TARGET}"

KERNEL_DEFCONFIG = "msm-kernel-${VM_TARGET}_tuivm-${KERNEL_VARIANT}defconfig"

CLANG_VERSION = "r487747c"
KERNEL_PLATFORM_PATH ?= "${WORKSPACE}/kernel-${PREFERRED_VERSION_linux-msm}/kernel_platform/"
KERNEL_TYPE = "dist"

KERNEL_PREBUILT_DISTDIR ?= "${WORKSPACE}/kernel-${PREFERRED_VERSION_linux-msm}/out/msm-kernel-${VM_TARGET}_tuivm-${KERNEL_VARIANT}defconfig/dist"

MACHINE_USES_KERNEL_PREBUILTS = "True"
KERNEL_PREBUILT_PATH ?= "${WORKSPACE}/kernel-${PREFERRED_VERSION_linux-msm}/out/msm-kernel-${VM_TARGET}_tuivm-${KERNEL_VARIANT}defconfig"
KERNEL_OUT_PATH = "${WORKSPACE}/kernel-${PREFERRED_VERSION_linux-msm}/out/msm-kernel-${VM_TARGET}_tuivm-${KERNEL_VARIANT}defconfig/"
KERNEL_BUILD_CONFIG = "msm-kernel/build.config.msm.${VM_TARGET}.tuivm"

KERNEL_DTB_NAMES = "seraph-vm-rumi.dtb seraph-vm-atp.dtb seraphp-vm-atp.dtb seraph-vm-idp-dtof.dtb seraphp-vm-idp-dtof.dtb seraph-vm-idp.dtb seraphp-vm-idp.dtb"

# filesystem configurations to be applied on image.
MACHINE_FSCONFIG_CONF = "trustedvm-fsconfig.conf"
MACHINE_SUPPORTS_USB = "False"
MACHINE_SUPPORTS_ANDROID_PROPERTIES = "False"
MACHINE_SUPPORTS_DISPLAY = "False"
MACHINE_SUPPORTS_SECUREMSM = "True"
MACHINE_SUPPORTS_MINK = "True"
MACHINE_SUPPORTS_TOUCH = "False"
MACHINE_SUPPORTS_OEMVM = "False"
MACHINE_MNT_POINTS = ""
ENABLE_ADB = "False"
# Formats of root filesystem images.
IMAGE_FSTYPES += "ext4"
IMAGE_INIT_MANAGER = "systemd"

VALG = 'False'

SYSTEMIMAGE_TARGET = "system.img"
VMUSERDATAIMAGE_TARGET = "vm-userdata.img"
VMIMAGE_TARGET = "vm-bootsys.img"
VMPERSIST_TARGET = "vm-persist.img"
DTB_TARGET = "vm.dtb"
KERNEL_OFFSET_TRUSTEDVM = "0x0"
DTB_OFFSET_TRUSTEDVM = "0x2000000"
RAMDISK_OFFSET_TRUSTEDVM = "0x2400000"
CMDLINE_OFFSET_TRUSTEDVM = "0x2401000"

KERNEL_OFFSET_OEMVM = "0x0"
DTB_OFFSET_OEMVM = "0x2000000"
RAMDISK_OFFSET_OEMVM = "0x2100000"
CMDLINE_OFFSET_OEMVM = "0x2101000"

# Ramdisk size is 8 MB
RAMDISK_SIZE = "10388608"

SYSTEM_SIZE_EXT4 ?= "235000000"
USERDATA_SIZE_EXT4 ?= "25000000"
PERSIST_IMAGE_ROOTFS_SIZE = "119000000"
PERSIST_SIZE_EXT4 = "119000000"
VM_PERSIST_SIZE_EXT4 ?= "125829120"
VM_SIZE_EXT4 ?= "560000000"

MACHINE_FEATURES:append = " qti-multivm dm-verity-cpio-cmdline qti-vm qti-vm-persist qti-smmu-proxy vm-dynamic-memresize qti-vm-target qti-vm-vsock qti-vm-mink"

PREFERRED_PROVIDER_virtual/base-utils = "toybox"
VIRTUAL-RUNTIME_base-utils = "toybox"
VIRTUAL-RUNTIME_base-utils-hwclock = ""
VIRTUAL-RUNTIME_base-utils-syslog = ""
VIRTUAL-RUNTIME_login_manager = ""
INIT_MANAGER = "systemd"
TOYBOX_RAMDISK = "True"

# On msm-5.4 or above ufs driver supports BSG Device.
UFS_BSG_DEV_USAGE = "True"
```
