## conf/machine/ar-sg1.conf
```bitbake
#@TYPE: Machine
#@NAME: AR-Gen1
#@DESCRIPTION: Machine configuration for Neo

require conf/machine/include/neo.inc

KERNEL_IMAGETYPE   = "Image"

MACHINE_SUPPORTS_DTBO = "True"
KERNEL_DTB_NAMES   = " \
    neo.dtb \
    neo_la.dtb \
    neo_luna-v2.dtb \
"
MACHINE_USES_KERNEL_PREBUILTS = "False"

KERNEL_DEFCONFIG = "msm-kernel-neo_le-perf_defconfig"
KERNEL_DEFCONFIG:qti-distro-debug = "msm-kernel-neo_le-debug_defconfig"

#Various kernel directories
KERNEL_PLATFORM_PATH = "${WORKSPACE}/kernel-6.1/kernel_platform"

KERNEL_MODULES_LIST = "modules.list.msm.neo-le"

KERNEL_BASE        = "0x80000000"

KERNEL_CONFIG     ?= "generic_sxr_defconfig"

CONSOLE_PARAM     ?= ""
CONSOLE_PARAM:qti-distro-debug ?= "console=ttyMSM0,115200,n8 earlycon msm_geni_serial.con_enabled=1 earlycon=msm_geni_serial,0x00A94000"
CONSOLE_PARAM:qti-distro-perf ?= "                                        "

KERNEL_CMD_PARAMS  = "${CONSOLE_PARAM} verity=enabled"

#Remove verity=enabled from kernel cmd line, when dm-verity is disabled.
KERNEL_CMD_PARAMS:remove = "${@bb.utils.contains('MACHINE_FEATURES', 'dm-verity-none', 'verity=enabled', '', d)}"

#Append 'avb-verity=enabled' to cmd line when avb is enabled.
KERNEL_CMD_PARAMS:append  = "${@bb.utils.contains('MACHINE_FEATURES', 'qti-avb', ' avb-verity=enabled', '', d)}"

SERIAL_CONSOLES    ?= ""
SERIAL_CONSOLES:qti-distro-debug = "115200;ttyMSM0"

# bootloader configuration
EXTRA_IMAGEDEPENDS += "edk2"

# Default USB composition to be picked
USBCOMPOSITION = "9060"

# Conf with partition entries required for machine.
MACHINE_PARTITION_CONF = "sxrneo-partition.conf"

# filesystem configurations to be applied on image.
MACHINE_FSCONFIG_CONF = "neo-fsconfig.conf"

# init ramdisk image to be used for first stage boot.
INITRAMFS_IMAGE = "qti-ramdisk-image"
INITRAMFS_FSTYPES = "cpio.lz4"
VENDOR_INITRAMFS_IMAGE = "qti-vendor-ramdisk-image"

# File indicating firmware residing places on device.
MACHINE_FILESMAP_CONF = "neo-filesmap"

# Enable qti-ab-boot feature with OTA package
GENERATE_AB_OTA_PACKAGE = "1"

#do not redirect system and journal logs to console
NO_SYS_JOURNAL_LOGS_TO_CONSOLE = "1"

#Flag to disable usbd.service
USB_PERIPHERAL_ONLY_MODE = "True"

USE_CLANG = "True"

HIBERNATION_NO_AES = "True"
HIBERNATION_PARTITION_NAME = "swap"
HIBERNATION_TZ_ENC = "True"

MACHINE_FEATURES += "drm emmc-boot qti-adsp qti-audio qti-cdsp qti-eva qti-camera qti-crypto \
                     qti-ab-boot qti-sensors qti-audio qti-tzlog smcinvoke qti-bluetooth \
                     qti-wifi qwesd file-based-encryption qti-codec2 qti-smciqseecomd \
                     dm-verity-none qti-smmu-proxy"

PREFERRED_VERSION_linux-msm = "6.1"
PREFERRED_VERSION_mod-signing-keys = "6.1"
PREFERRED_VERSION_kernel-toolchain-native = "6.1.32bit"
PREFERRED_VERSION_mkbootimg-gki = "6.1"
PREFERRED_VERSION_mkbootimg-gki-native = "6.1"
PREFERRED_VERSION_msm-bus = "6.1"
PREFERRED_VERSION_gki-kernel-modules = "6.1"
PREFERRED_VERSION_merge-dtbs-gki-native = "6.1"
PREFERRED_VERSION_displaydlkm = "6.1"
PREFERRED_VERSION_displaydevicetree = "6.1"
PREFERRED_VERSION_securemsmdlkm = "6.1"
PREFERRED_VERSION_mmrm-kernel = "6.1"
PREFERRED_VERSION_video-kernel = "6.1"
PREFERRED_VERSION_video-devicetree = "6.1"
PREFERRED_VERSION_audiodlkm = "6.1"
PREFERRED_VERSION_audiodevicetree= "6.1"
PREFERRED_VERSION_fastrpc-kernel = "6.1"
PREFERRED_VERSION_eva-kernel = "6.1"
PREFERRED_VERSION_qti-eva-kernel-headers = "6.1"
PREFERRED_VERSION_synx-kernel = "6.1"
PREFERRED_VERSION_wlan-platform = "6.1"
PREFERRED_VERSION_qcacld32-ar-sg1 = "6.1"
PREFERRED_VERSION_eva-devicetree = "6.1"
PREFERRED_VERSION_synx-kernel-header = "6.1"
PREFERRED_VERSION_graphicsdevicetree = "6.1"
PREFERRED_VERSION_graphicsdlkm = "6.1"
PREFERRED_VERSION_cameradlkm = "6.1"
PREFERRED_VERSION_cameradtb = "6.1"
PREFERRED_VERSION_edk2 = "6.1"

# qti-avb:   Support QTI Andorid Verified boot
MACHINE_FEATURES += "qti-avb"
PREFERRED_PROVIDER_virtual/kernel = "linux-msm-src"
PREFERRED_PROVIDER_linux-msm-headers = "linux-msm-headers-src"
PREFERRED_PROVIDER_fastrpc-kernel = "fastrpc-kernel-src"
```

## conf/machine/echo-ab-common.conf
```bitbake
#@TYPE: Machine
#@NAME: ECHO-AB
#@DESCRIPTION: Machine configuration for Amboseli-RDKB-AB
BASEMACHINE ?= "echo"

MACHINE_FEATURES += "qti-ab-boot qti-recoveryinfo"

MACHINE_FEATURES_remove += "qti-recovery"

MACHINE_PARTITION_CONF = "echo-ab-partition.conf"

GENERATE_AB_OTA_PACKAGE = "1"

MACHINE_SUPPORTS_A_SUFFIX = "False"
```

## conf/machine/echo-ab-verity.conf
```bitbake
#@TYPE: Machine
#@NAME: ECHO-AB
#@DESCRIPTION: Machine configuration for Amboseli-RDKB-AB

require ${COREBASE}/meta-qti-bsp/conf/machine/echo-verity.conf

require ${COREBASE}/meta-qti-bsp/conf/machine/echo-ab-common.conf
```

## conf/machine/echo-ab.conf
```bitbake
#@TYPE: Machine
#@NAME: ECHO-AB
#@DESCRIPTION: Machine configuration for Amboseli-RKDB AB

require ${COREBASE}/meta-qti-bsp/conf/machine/echo.conf

require ${COREBASE}/meta-qti-bsp/conf/machine/echo-ab-common.conf
```

## conf/machine/echo-base.conf
```bitbake
#@TYPE: Machine
#@NAME: ECHO
#@DESCRIPTION: Machine configuration for Amboseli-RDKB
BASEMACHINE ?= "echo"
require conf/machine/include/basemachine.inc

include conf/machine/include/arm/arch-armv8a.inc

PREFERRED_PROVIDER_virtual/kernel = "linux-msm-src"
PREFERRED_PROVIDER_linux-msm-headers = "linux-kernel-qcom-headers"
PREFERRED_PROVIDER_virtual/mkbootimg = "mkbootimg-gki"
PREFERRED_PROVIDER_virtual/mkdtimg   = "mkdtimg-gki"
PREFERRED_VERSION_linux-msm ?= "6.18"
PREFERRED_VERSION_linux-msm-headers ?= "6.18"
#PREFERRED_VERSION_kernel-toolchain ?= "5.15"
PREFERRED_VERSION_mkbootimg-gki ?= "6.18"
PREFERRED_VERSION_mkbootimg-gki-native = "6.18"
PREFERRED_VERSION_mod-signing-keys ?= "6.18"
PREFERRED_VERSION_merge-dtbs-gki-native = "6.18"
PREFERRED_VERSION_gki-kernel-modules = "6.18"
#PREFERRED_VERSION:securemsmdlkm ?= "1.0"
PREFERRED_VERSION_sat-module ?= "6.1"
PREFERRED_VERSION_libvmmem ?= "2.0"

### KERNEL ####
MACHINE_USES_KERNEL_PREBUILTS = "False"
KERNEL_VARIANT = ""
KERNEL_VARIANT_qti-distro-nogplv3-debug = "debug_"
KERNEL_VARIANT_qti-distro-nogplv3-perf = "perf_"
KERNEL_VARIANT_qti-distro-nogplv3-user = "user_"
KERNEL_VARIANT_qti-distro-base-debug = "debug_"
KERNEL_VARIANT_qti-distro-base-perf = "perf_"
KERNEL_VARIANT_qti-distro-base-user = "user_"
INITRAMFS_IMAGE = "qti-ramdisk-image"
INITRAMFS_FSTYPES = "cpio.lz4"
VENDOR_INITRAMFS_IMAGE = "qti-vendor-ramdisk-image"

#KERNEL_CONF ?= "qcom_base_defconfig"
KERNEL_DEFCONFIG = "qcom_base_defconfig"
KERNEL_CONFIG = "qcom_base_defconfig"

#Various kernel directories
KERNEL_PLATFORM_PATH = "${WORKSPACE}/kernel-6.18/kernel_platform"
#KERNEL_PREBUILT_PATH = "${WORKSPACE}/kernel-5.15/out/${KERNEL_DEFCONFIG}"
#KERNEL_PREBUILT_DISTDIR = "${WORKSPACE}/kernel-5.15/out/${KERNEL_DEFCONFIG}/dist"
#KERNEL_BUILD_CONFIG = "msm-kernel/${KERNEL_CONFIG}"
#KERNEL_OUT_PATH = "${KERNEL_PREBUILT_PATH}"

#### dtb ####
KERNEL_DTB_NAMES   = " \
    echo.dtb \
    echo-idp-emmc.dtb \
    echo-idp-qmp5-emmc.dtb \
    echo-idp-lga.dtb \
    echo-idp-lga-v2.dtb \
    echo-idp-lga-v3.dtb \
    echo-idp-lga-v4.dtb \
    echo-idp-lga-emmc.dtb \
    echo-idp-lga-v2-emmc.dtb \
    echo-idp-lga-v3-emmc.dtb \
    echo-idp-lga-v4-emmc.dtb \
"
#MACHINE_SUPPORTS_DTBO = "True"
BUILD_WITH_TECHPACKS = "1"
SKIP_VENDOR_BOOT = "True"

#### boot.img ####
KERNEL_IMAGETYPE = "Image"
KERNEL_BASE = "0x80000000"
#KERNEL_TAGS_OFFSET = "0x80000000"
BOOT_HEADER_VERSION = "2"

#### cmdline ####
# use no gpl V3
CONSOLE_PARAM:qti-distro-perf  = "ro rootwait console=ttyMSM0,115200n8 androidboot.hardware=qcom msm_rtb.filter=0x237 androidboot.console=ttyMSM0 lpm_levels.sleep_disabled=1 firmware_class.path=/lib/firmware/updates,/firmware/image service_locator.enable=1 net.ifnames=0 atlantic_fwd.rx_ring_size=512 atlantic_fwd.rx_linear=1 pcie_ports=compat pci=pcie_bus_safe no_console_suspend=1 loglevel=0 qcom_scm.download_mode=1"
CONSOLE_PARAM:qti-distro-debug = "ro rootwait console=ttyMSM0,115200n8 androidboot.hardware=qcom msm_rtb.filter=0x237 androidboot.console=ttyMSM0 lpm_levels.sleep_disabled=1 firmware_class.path=/lib/firmware/updates,/firmware/image service_locator.enable=1 net.ifnames=0 atlantic_fwd.rx_ring_size=512 atlantic_fwd.rx_linear=1 pcie_ports=compat pci=pcie_bus_safe qcom_scm.download_mode=1"
KERNEL_CMD_PARAMS = "${CONSOLE_PARAM}"

#### systemd ####
SERIAL_CONSOLES ?= "115200;ttyMSM0"

#### others ####
PAGE_SIZE ?= '4096'

#Abl would be enabled later
EXTRA_IMAGEDEPENDS += "edk2"
PREFERRED_VERSION_edk2 ?= "6.18"
ENABLE_SIGNED_IMAGES = "1"
# Will enabled DM-verity later
# DISTRO_FEATURES += "dm-verity"

# TODO: Temporary change to override BB_SIGNATURE_HANDLER set in local.conf.
# Other machines are already supporting OEEquivHash as hashing signature.
# Fix build issues observed in this machine and remove this override.
#BB_SIGNATURE_HANDLER = "OEBasicHash"

#QSEEComCompat and QSEECom are mutually exlusive and QSEEComCompat depends on  smcinvoke
#lv-build builds the required listernes , le_qseecom enables qseecomd
# qti-location:           Machine supports Location solution
MACHINE_FEATURES += "systemd qti-sdx drm emmc-boot dm-verity-none mount-dsp-firmware qti-recovery var-persist qti-location"

##############################################################

# SElinux enablement in enforcing mode

#############################################################

# DEFAULT_ENFORCING = "permissive"
MACHINE_MNT_POINTS = " \
        /persist \
        /firmware \
        /rdklogs \
        /cache \
        /nvram \
        /data \
        /systemrw \
        /dsp \
"


#UBINIZE_ARGS ?= "-m 4096 -p 256KiB -s 4096"
#MKUBIFS_ARGS ?= "-m 4096 -e 253952 -c 2146 -F"
#MKUBIFS_USRFS_ARGS ?= "-m 4096 -e 253952 -c 2146 -F"
# Sysfs ubi volume sizes
#SYSTEM_VOLUME_SIZE ?= "110MiB"
# rootfs volume size for 1GB storage
#SYSTEM_VOLUME_SIZE_G ?= "214MiB"
#CACHE_VOLUME_SIZE ?= "15MiB"
SYSTEMRW_VOLUME_SIZE ?= "6MiB"
PERSIST_VOLUME_SIZE ?= "8MiB"
SYSTEM_SIZE_EXT4   ?= "1GiB"
NVRAM_SIZE_EXT4   ?= "52428800"
USERDATA_SIZE ?= "2GiB"
CACHE_SIZE_EXT4 ?= "72MiB"
PERSIST_SIZE_EXT4 ?= "8192KB"

# Formats of root filesystem images
IMAGE_FSTYPES += "ext4"
MACHINE_SUPPORTS_PDMAPPER = "True"
MACHINE_SUPPORTS_ANDROID_PROPERTIES = "False"
# Subsystem Ramdump support
MACHINE_SUPPORTS_SSR = "True"

MACHINE_FSCONFIG_CONF = "echo-fsconfig.conf"
#MACHINE_UBIFS_FSCONFIG_CONF = "sdxpinn-ubi-fsconfig.conf"

USBCOMPOSITION = "90DB"

RAMDISK_TMPFS = "False"
#MACHINE_SUPPORTS_INIT_RAMDISK = "False"
#MACHINE_SUPPORTS_ADB_OVER_PCIE = "False"
#MACHINE_SUPPORTS_DIAG_OVER_PCIE = "False"

# Partition conf
MACHINE_PARTITION_CONF = "echo-partition.conf"

# File indicating firmware residing places on device.
MACHINE_FILESMAP_CONF_EMMC = "echo-emmc-filesmap"
MACHINE_FILESMAP_CONF = "echo-filesmap"

# On msm-5.4 or above ufs driver supports BSG Device.
UFS_BSG_DEV_USAGE = "True"

### MACHINE_FEATURES ###
DISTRO_FEATURES:remove = "selinux"

GENERATE_AB_OTA_PACKAGE = "0"
```

## conf/machine/echo-min.conf
```bitbake
#@TYPE: Machine
#@NAME: ECHO
#@DESCRIPTION: Machine configuration for Amboseli-RDKB
require ${COREBASE}/meta-qti-bsp/conf/machine/echo-base.conf

MACHINE_FEATURES += "dm-verity-none"

KERNEL_CONFIG_FRAGMENTS:append = " \
    ${S}/arch/arm64/configs/vendor/echo-mbb.config \
    ${S}/arch/arm64/configs/vendor/echo-rdkb.config"
KERNEL_CONFIG_FRAGMENTS:append = " ${@oe.utils.vartrue('DEBUG_BUILD', '${S}/arch/arm64/configs/vendor/echo-debug.config', '', d)}"
```

## conf/machine/echo.conf
```bitbake
#@TYPE: Machine
#@NAME: ECHO
#@DESCRIPTION: Machine configuration for Amboseli-RDKB
require ${COREBASE}/meta-qti-bsp/conf/machine/echo-base.conf

MACHINE_FEATURES += "dm-verity-none"
```
