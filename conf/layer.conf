## conf/machine/pebble.conf
```bitbake
#@TYPE: Machine
#@NAME: pebble
#@DESCRIPTION: Machine configuration for QTI Hardware with pebble
BASEMACHINE ?= "pebble"
require conf/machine/include/basemachine.inc

DEFAULTTUNE ?= "aarch64"
include conf/machine/include/arm/arch-armv8a.inc

MSM_KERNEL_VERSION = "6.18"
require recipes-kernel/linux-msm/msm-common.inc

# ENABLE_UEFI_EFI_BOOT = "1"
PREFERRED_VERSION_edk2 = "git"
PREFERRED_VERSION_synx-devicetree ?= "6.18"
PREFERRED_VERSION_synx-kernel-header ?= "6.18"
PREFERRED_VERSION_synx-core ?= "6.18"
PREFERRED_VERSION_synx-kernel ?= "6.18"
PREFERRED_VERSION_securemsmdlkm ?= "1.1"
PREFERRED_VERSION_mod-blacklist ?= "2.0"
PREFERRED_PROVIDER_virtual/mkbootimg = "mkbootimg"
PREFERRED_VERSION_mkbootimg = "${MSM_KERNEL_VERSION}"
PREFERRED_VERSION_mkbootimg-native = "${MSM_KERNEL_VERSION}"

MACHINE_USES_KERNEL_PREBUILTS = "True"
DDK_BUILD ?= "true"
OVERRIDES .= "${@':pureyocto' if (d.getVar('MACHINE_USES_KERNEL_PREBUILTS') or 'true').strip().lower() == 'false' else ':prebuilt'}"

# [-- Pure Yocto path
PREFERRED_PROVIDER_virtual/kernel:pureyocto = "linux-common-soc"
PREFERRED_PROVIDER_linux-msm-headers:pureyocto = "linux-soc-headers"
PREFERRED_VERSION_fastrpc-kernel:pureyocto = "1.0"
PREFERRED_VERSION_securemsmdlkm:pureyocto = "1.0"
PREFERRED_VERSION_displaydlkm:pureyocto = "1.0"
PREFERRED_VERSION_mmdlkm:pureyocto = "1.0"
PREFERRED_VERSION_audiodlkm:pureyocto = "1.0"
PREFERRED_VERSION_cameradlkm:pureyocto = "1.0"
PREFERRED_VERSION_msm-bus:pureyocto = "1.0"
DDK_BUILD:pureyocto = "false"
#remove ramdisk
INITRAMFS_IMAGE:pureyocto = ""
INITRAMFS_FSTYPES:pureyocto = ""
VENDOR_INITRAMFS_IMAGE:pureyocto = ""
# Pure Yocto path end --]

# [-- Bazel + DDK + prebuilt path
#PREFERRED_VERSION_video-kernel:prebuilt = "1.1"
#PREFERRED_VERSION_mmrm-kernel:prebuilt = "1.1"
#PREFERRED_VERSION_eva-kernel:prebuilt = "1.0"
#PREFERRED_VERSION_synx-kernel:prebuilt = "0.0"
#PREFERRED_VERSION_touchdlkm:prebuilt = "2.0%"
#PREFERRED_VERSION_synx-core:prebuilt = "0.0"
#DDK_BUILD:prebuilt = "true"
# Bazel + DDK + prebuilt path end --]

TARGET_CONFIG_FRAGMENTS = "pebble_le.cfg"
TARGET_CONFIG_FRAGMENTS:append = " ${@oe.utils.vartrue('DEBUG_BUILD', ' pebble_le_debug.cfg', '', d)}"

PEBBLE_BASE_DT = "pebble.dtb pebblep.dtb"
PEBBLE_OVERLAY = " \
    pebble-atp-overlay.dtbo \
    pebble-atp-ufs5-overlay.dtbo \
    pebble-cdp-fig-pandeiro-overlay.dtbo \
    pebble-cdp-fig-pandeiro-ufs5-overlay.dtbo \
    pebble-cdp-overlay.dtbo \
    pebble-cdp-ufs5-overlay.dtbo \
    pebble-cdp-wcn7750-overlay.dtbo \
    pebble-mtp-fig-overlay.dtbo \
    pebble-mtp-overlay.dtbo \
    pebble-mtp-rf-pandeiro-overlay.dtbo \
    pebble-mtp-rf-pandeiro-st33j-overlay.dtbo \
    pebble-mtp-rf-pandeiro-st33j-ufs5-overlay.dtbo \
    pebble-mtp-rf-pandeiro-ufs5-overlay.dtbo \
    pebble-qrd-overlay.dtbo \
    pebble-qrd-ufs5-overlay.dtbo \
    pebble-qrd-wcn7750-overlay.dtbo \
    pebble-rcm-overlay.dtbo \
    pebble-rcm-ufs5-overlay.dtbo \
    pebble-rcm-ufs5-wcn7750-overlay.dtbo \
    pebble-rcm-wcn7750-overlay.dtbo \
    pebble-rumi-overlay.dtbo \
"
TARGET_DTBS = "${PEBBLE_BASE_DT} ${PEBBLE_OVERLAY}"
KERNEL_IS_SOC_REPO = "True"

KERNEL_BUILD_TOOLS_ARCH = "linux_musl-x86"
HOSTTOOLS += "rsync nproc"

# clang version for kernel toolchain 6.18
USE_CLANG = "True"
CLANG_VERSION = "r584948"

# enable aosp-llvm
INHERIT += "aospllvm"

#### KERNEL ####
KERNEL_SRC_TYPE = "soc-repo"
KERNEL_MODULES_LIST = "modules-lists/modules.list.msm.pebble-le"
KERNEL_MODULES_BLACKLIST = "\
    modules.vendor_blocklist.msm.pebble-le \
    modules.systemdlkm_blocklist.msm.pebble-le \
"
KERNEL_DEFCONFIG_VARIANT:qti-distro-debug = "debug-defconfig"
KERNEL_DEFCONFIG_VARIANT:qti-distro-perf = "defconfig"

#extra module blacklist
EXTRA_BLACKLIST_MOD ?= ""

TARGET_BOARD_PLATFORM = "pebble-le"
KERNEL_CONFIG  ?= "build.config.msm.pebble.le"
KERNEL_BUILD_CONFIG = "soc-repo/${KERNEL_CONFIG}"

#### dtb ####
KERNEL_DTB_NAMES = "pebble.dtb pebblep.dtb"

MACHINE_SUPPORTS_DTBO= "True"
BUILD_WITH_TECHPACKS = "1"
SKIP_VENDOR_BOOT = "False"

#### boot.img ####
KERNEL_IMAGETYPE = "Image"
KERNEL_BASE = "0x80000000"
KERNEL_TAGS_OFFSET = "0x80000000"
BOOT_HEADER_VERSION = "2"

#### systemd ####
SERIAL_CONSOLE ?= "115200;ttyMSM0"

#### cmdline ####
CONSOLE_PARAM:qti-distro-perf  = ""
CONSOLE_PARAM:qti-distro-debug = "console=ttyMSM0,115200n8 kasan.stacktrace=off stack_depot_disable=off page_owner=on no_hash_pointers panic_on_taint=0x20 slub_debug=FZP,zs_handle,zspage;FZPU qcom_geni_serial.con_enabled=1 earlycon"
HIBERNATION_PAPAMS = "hibernate=nocompress"
KERNEL_CMD_PARAMS = "${CONSOLE_PARAM}"

#### others ####
PAGE_SIZE ?= '4096'
SDCARD_DEVICE = "mmcblk1p1"

# TODO: Temporary change to override BB_SIGNATURE_HANDLER set in local.conf.
# Other machines are already supporting OEEquivHash as hashing signature.
# Fix build issues observed in this machine and remove this override.
BB_SIGNATURE_HANDLER = "OEBasicHash"

#QSEEComCompat and QSEECom are mutually exlusive and QSEEComCompat depends on  smcinvoke
#lv-build builds the required listernes , le_qseecom enables qseecomd
MACHINE_FEATURES += "dm-verity-none"

MACHINE_MNT_POINTS = " \
	/persist \
	/firmware \
	/bt_firmware \
	/dsp \
	/overlay \
"

SYSTEM_SIZE_EXT4   ?= "4026531840"
PERSIST_SIZE_EXT4 ?= "7MiB"
# Define userdata dir, size to be used
USERDATA_DIR = "${@bb.utils.contains('MACHINE_MNT_POINTS', '/overlay', 'overlay', 'data', d)}"
USERDATA_SIZE ?= "60GiB"

# Formats of root filesystem images
IMAGE_FSTYPES += "ext4"
MACHINE_SUPPORTS_PDMAPPER = "True"
MACHINE_SUPPORTS_ANDROID_PROPERTIES = "True"
MACHINE_FSCONFIG_CONF = "pebble-fsconfig.conf"
MACHINE_SUPPORTS_DISPLAY = "False"
MACHINE_SUPPORTS_SSR = "False"

USBCOMPOSITION = "901D"

# Partition conf
MACHINE_PARTITION_CONF = "pebble-partition.conf"

# File indicating firmware residing places on device.
MACHINE_FILESMAP_CONF = "pebble-filesmap"

### MACHINE_FEATURES ###
#MACHINE_FEATURES += "qti-ab-boot qti-adsp qti-cdsp fastrpc qti-tzlog qti-crypto qti-security qseecompat qti-smciqseecomd"
MACHINE_FEATURES += "qti-ab-boot qti-audio qti-video qti-adsp qti-cdsp fastrpc"

# On msm-5.4 or above ufs driver supports BSG Device.
UFS_BSG_DEV_USAGE = "True"

DISTRO_FEATURES:remove = "qti-vble qti-sensors qti-sensors-prop qti-location qti-fastcv ros2 qirp-sdk qti-ib2c qti-auto-framing-stabilization"
DISTRO_FEATURES:append = " qti-uvc"

QPERMISSIONS_ENABLE = "1"

DEFAULT_ENFORCING = "enforcing"

# pack for installation of ESDK
COREBASE_FILES:append = " meta-poky"

INHERIT:append:qti-distro-camerastack-debug = " bootconfig"
```

## conf/machine/pineapple.conf
```bitbake
#@TYPE: Machine
#@NAME: KALAMA
#@DESCRIPTION: Machine configuration for QTI MTP with KALAMA
BASEMACHINE ?= "pineapple"
require conf/machine/include/basemachine.inc

DEFAULTTUNE ?= "aarch64"
include conf/machine/include/arm/arch-armv8a.inc

PREFERRED_PROVIDER_virtual/mkbootimg = "mkbootimg-gki"
PREFERRED_PROVIDER_virtual/mkdtimg   = "mkdtimg-gki"
PREFERRED_VERSION_linux-msm ?= "6.1"
PREFERRED_VERSION_linux-msm-headers ?= "6.1"
PREFERRED_VERSION_kernel-toolchain ?= "6.1.32bit"
PREFERRED_VERSION_kernel-toolchain-native ?= "6.1.32bit"
PREFERRED_VERSION_dtc-android-build ?= "1.6.0"
PREFERRED_VERSION_mkbootimg-gki ?= "6.1"
PREFERRED_VERSION_mkbootimg-gki-native ?= "6.1"
PREFERRED_VERSION_gki-kernel-modules ?= "5.15"
PREFERRED_VERSION_mod-signing-keys ?= "6.1"
PREFERRED_VERSION_synx-kernel ?= "1.0"
PREFERRED_VERSION_securemsmdlkm ?= "1.1"
PREFERRED_VERSION_sat-module ?= "4.1"

#### KERNEL ####
MACHINE_USES_KERNEL_PREBUILTS = "True"
KERNEL_VARIANT:qti-distro-debug ?= "debug_defconfig"
KERNEL_VARIANT:qti-distro-perf ?= "perf_defconfig"
KERNEL_MODULES_LIST = "modules.list.msm.pineapple-le"
KERNEL_MODULES_BLACKLIST = "\
    modules.vendor_blocklist.msm.pineapple-le \
    modules.systemdlkm_blocklist.msm.pineapple-le \
"
# Check for msm-kernel or gki_kernel
KERNEL_TYPE = "dist"

#extra module blacklist
EXTRA_BLACKLIST_MOD ?= ""

INITRAMFS_IMAGE = "qti-ramdisk-image"
INITRAMFS_FSTYPES = "cpio.lz4"
VENDOR_INITRAMFS_IMAGE = "qti-vendor-ramdisk-image"

KERNEL_DEFCONFIG = "msm-kernel-pineapple_le-${KERNEL_VARIANT}"

#Various kernel directories
KERNEL_PLATFORM_PATH = "${WORKSPACE}/kernel-6.1/kernel_platform"
KERNEL_PREBUILT_PATH = "${WORKSPACE}/kernel-6.1/out/${KERNEL_DEFCONFIG}"
KERNEL_PREBUILT_DISTDIR = "${KERNEL_PREBUILT_PATH}/dist"

KERNEL_OUT_PATH = "${KERNEL_PREBUILT_PATH}"

KERNEL_CONFIG  ?= "build.config.msm.pineapple.le"
KERNEL_BUILD_CONFIG = "msm-kernel/${KERNEL_CONFIG}"

#### dtb ####
KERNEL_DTB_NAMES = "pineapple-v2.dtb pineapplep-v2.dtb pineapplep-qcs.dtb"

MACHINE_SUPPORTS_DTBO= "True"
BUILD_WITH_TECHPACKS = "1"
SKIP_VENDOR_BOOT = "False"

#### boot.img ####
KERNEL_IMAGETYPE = "Image"
KERNEL_BASE = "0x80000000"
KERNEL_TAGS_OFFSET = "0x80000000"
BOOT_HEADER_VERSION = "2"

#### systemd ####
SERIAL_CONSOLE ?= "115200;ttyMSM0"

#### cmdline ####
CONSOLE_PARAM:qti-distro-perf  = "qcom_geni_serial.con_enabled=0"
CONSOLE_PARAM:qti-distro-debug = "console=ttyMSM0,115200n8 earlycon qcom_geni_serial.con_enabled=1 androidboot.console=ttyMSM0 systemd.log_target=journal systemd.show_status=no"
HIBERNATION_PAPAMS = "hibernate=nocompress"
KERNEL_CMD_PARAMS = "${CONSOLE_PARAM} ${HIBERNATION_PAPAMS}"

#### others ####
PAGE_SIZE ?= '4096'
SDCARD_DEVICE = "mmcblk1p1"

#Abl would be enabled later
EXTRA_IMAGEDEPENDS += "edk2"
PREFERRED_VERSION_edk2 ?= "4.0"

# TODO: Temporary change to override BB_SIGNATURE_HANDLER set in local.conf.
# Other machines are already supporting OEEquivHash as hashing signature.
# Fix build issues observed in this machine and remove this override.
BB_SIGNATURE_HANDLER = "OEBasicHash"

#QSEEComCompat and QSEECom are mutually exlusive and QSEEComCompat depends on  smcinvoke
#lv-build builds the required listernes , le_qseecom enables qseecomd
MACHINE_FEATURES += "dm-verity-none"

MACHINE_MNT_POINTS = " \
	/persist \
	/firmware \
	/bt_firmware \
	/dsp \
	/overlay \
"

SYSTEM_SIZE_EXT4   ?= "2684354560"
PERSIST_SIZE_EXT4 ?= "7MiB"
# Define userdata dir, size to be used
USERDATA_DIR = "${@bb.utils.contains('MACHINE_MNT_POINTS', '/overlay', 'overlay', 'data', d)}"
USERDATA_SIZE ?= "60GiB"

# Formats of root filesystem images
IMAGE_FSTYPES += "ext4"
MACHINE_SUPPORTS_PDMAPPER = "True"
MACHINE_SUPPORTS_ANDROID_PROPERTIES = "True"
MACHINE_FSCONFIG_CONF = "pineapple-fsconfig.conf"

MACHINE_SUPPORTS_SSR = "True"

USBCOMPOSITION = "901D"

# Partition conf
MACHINE_PARTITION_CONF = "pineapple-partition.conf"

# File indicating firmware residing places on device.
MACHINE_FILESMAP_CONF = "pineapple-filesmap"

### MACHINE_FEATURES ###
MACHINE_FEATURES += "qti-ab-boot qti-audio qti-adsp qti-cdsp qti-uvc qti-eva qti-tzlog qti-crypto qseecompat smcinvoke qti-smciqseecomd file-based-encryption "

# On msm-5.4 or above ufs driver supports BSG Device.
UFS_BSG_DEV_USAGE = "True"

DISTRO_FEATURES:append = " qti-uvc "
DISTRO_FEATURES:remove = "qti-fastcv virtualization ros2 qirp-sdk qti-ib2c qti-auto-framing-stabilization "


QPERMISSIONS_ENABLE = "1"

DEFAULT_ENFORCING = "enforcing"
MACHINE_SUPPORTS_DISPLAY = "False"
```

## conf/machine/qcm2290-mtp-32.conf
```bitbake
#@TYPE: Machine
#@NAME: qcm2290-mtp-32
#@DESCRIPTION: Machine configuration for QCM220-MTP

require conf/machine/include/qcm2290-mtp.inc
require conf/machine/qcm2290-mtp.conf

PACKAGE_ARCHS:remove = " qcm2290-mtp"

# Multilib configuration
MULTILIB_ENABLED ?= "True"
require ${@bb.utils.contains('MULTILIB_ENABLED', 'False', '', 'conf/multilib.conf', d)}
MULTILIBS = "${@bb.utils.contains('MULTILIB_ENABLED', 'False', '', 'multilib:lib32', d)}"
DEFAULTTUNE:virtclass-multilib-lib32 = "${@bb.utils.contains('MULTILIB_ENABLED', 'False', '', 'armv7a', d)}"
MLIBPREFIX = "${@bb.utils.contains('MULTILIB_ENABLED', 'False', '', 'lib32-', d)}"
TOOLCHAIN_TYPE = "internal"
IMAGE_INSTALL:append = " lib32-glibc lib32-libgcc lib32-libstdc++"

DISTRO_FEATURES:remove = " tensorflow-lite"

NON_MULTILIB_RECIPES += " sat-module gki-kernel-modules kernel-modules msm-bus security-tests-llvm recovery-ab mmrm-kernel drm wlan-platform qcacld32-ll-debug"
NON_MULTILIB_RECIPES += " video-kernel audiodlkm mmdlkm make-mod-scripts displaydlkm cameradlkm securemsmdlkm graphicsdlkm touchdlkm bt-dlkm-kernel btdevicetree dataipa"
```

## conf/machine/qcm4325-mtp-32.conf
```bitbake
#@TYPE: Machine
#@NAME: qcm4325-mtp-32
#@DESCRIPTION: Machine configuration for QCM4325-mtp

require conf/machine/include/qcm4325-mtp.inc
require conf/machine/qcm4325-mtp.conf

PACKAGE_ARCHS:remove = " qcm4325-mtp"

# Multilib configuration
MULTILIB_ENABLED ?= "True"
require ${@bb.utils.contains('MULTILIB_ENABLED', 'False', '', 'conf/multilib.conf', d)}
MULTILIBS = "${@bb.utils.contains('MULTILIB_ENABLED', 'False', '', 'multilib:lib32', d)}"
DEFAULTTUNE:virtclass-multilib-lib32 = "${@bb.utils.contains('MULTILIB_ENABLED', 'False', '', 'armv7ahf-neon', d)}"
MLIBPREFIX = "${@bb.utils.contains('MULTILIB_ENABLED', 'False', '', 'lib32-', d)}"
TOOLCHAIN_TYPE = "internal"
IMAGE_INSTALL:append = " lib32-glibc lib32-libgcc lib32-libstdc++"

DISTRO_FEATURES:remove = " tensorflow-lite"

NON_MULTILIB_RECIPES += " sat-module gki-kernel-modules kernel-modules msm-bus security-tests-llvm recovery-ab mmrm-kernel drm wlan-platform qcacld32-ll-debug"
NON_MULTILIB_RECIPES += " video-kernel audiodlkm mmdlkm make-mod-scripts displaydlkm cameradlkm securemsmdlkm graphicsdlkm touchdlkm bt-dlkm-kernel btdevicetree dataipa"
```
