## conf/machine/trustedvm-v2-3.conf
```bitbake
#@TYPE: Machine
#@NAME: TRUSTEDVM-V2-3
#@DESCRIPTION: Machine configuration for QTI MTP with TRUSTEDVM

BASEMACHINE = "trustedvm-v2-3"
require conf/machine/include/basemachine.inc

DEFAULTTUNE = "aarch64"
include conf/machine/include/arm/arch-armv8a.inc

PREFERRED_PROVIDER_virtual/mkbootimg = "mkbootimg-gki"
PREFERRED_PROVIDER_virtual/mkdtimg   = "mkdtimg-gki"
PREFERRED_PROVIDER_virtual/kernel   = "linux-soc-repo"
#PREFERRED_PROVIDER_virtual/dtc-native = "dtc-android-build-native"
PREFERRED_VERSION_touchdlkm = "2.0"
PREFERRED_VERSION_displaydlkm = "2.0"
PREFERRED_VERSION_linux-msm = "${VM_KERNEL_VERSION}"
PREFERRED_VERSION_linux-msm-headers = "6.11"
PREFERRED_VERSION_kernel-toolchain ?= "${PREFERRED_VERSION_linux-msm}"
PREFERRED_VERSION_kernel-toolchain-native = "${PREFERRED_VERSION_linux-msm}"
PREFERRED_VERSION_dtc-android-build ?= "${PREFERRED_VERSION_linux-msm}"
PREFERRED_VERSION_mkbootimg-gki ?= "${PREFERRED_VERSION_linux-msm}"
PREFERRED_VERSION_coreutils ?= "6.9"
PREFERRED_PROVIDER_virtual/refpolicy = "refpolicy-mls-vm"

LLVM_VERSION = "8.0"

PAGE_SIZE ?= '4096'

EXTRA_IMAGECMD ?= "-N 2048"

KERNEL_IMAGETYPE = "Image"
KERNEL_CMD_PARAMS = ""
KERNEL_VARIANT = ""
KERNEL_VARIANT:qti-distro-base-debug = "debug_"
KERNEL_DEFCONFIG_VARIANT = "defconfig"
KERNEL_DEFCONFIG_VARIANT:qti-distro-base-debug = "debug-defconfig"
KERNEL_HEADERS_VARIANT:qti-distro-base-debug = "debug-"
SERIAL_CONSOLE = "115200 hvc0"
VM_TARGET = "${VM_KERNEL_TARGET}"

MACHINE_USES_KERNEL_PREBUILTS = "True"
KERNEL_PLATFORM_PATH ?= "${WORKSPACE}/kernel-${PREFERRED_VERSION_linux-msm}/kernel_platform/"
KERNEL_PREBUILT_PATH ?= "${WORKSPACE}/kernel-${PREFERRED_VERSION_linux-msm}/out/msm-kernel-${VM_TARGET}_vms-${KERNEL_VARIANT}defconfig/"
KERNEL_PREBUILT_DISTDIR ?= "${WORKSPACE}/kernel-${PREFERRED_VERSION_linux-msm}/out/msm-kernel-${VM_TARGET}_vms-${KERNEL_VARIANT}defconfig/dist"
KERNEL_TYPE = "dist"
TARGET_BOARD_PLATFORM="${VM_KERNEL_TARGET}-tuivm"
DDK_BUILD="true"
KP_STRIP_VERSION="11.5.0"
CLANG_VERSION="r536225"

KERNEL_TOOLS_USES_MUSLC = "True"
LD_PATH_MUSLC = "${WORKSPACE}/kernel-${PREFERRED_VERSION_linux-msm}/kernel_platform/prebuilts/kernel-build-tools/linux_musl-x86/lib64/"
LD_PATH_GLIBC = "${WORKSPACE}/kernel-${PREFERRED_VERSION_linux-msm}/kernel_platform/prebuilts/kernel-build-tools/linux-x86/lib64/"

#### KERNEL ####
# Check for soc-repo or gki_kernel
KERNEL_TYPE = "dist"


KERNEL_OUT_PATH = "${KERNEL_PREBUILT_PATH}"
KERNEL_CONFIG  ?= "build.config.msm.${VM_TARGET}.vm"
KERNEL_BUILD_CONFIG = "soc-repo/${KERNEL_CONFIG}"
KERNEL_IS_SOC_REPO ="True"

#### dtb ####
KERNEL_DTB_NAMES = "shikra-vm-*.dtb shikra-oemvm-*.dtb"


# filesystem configurations to be applied on image.
MACHINE_FSCONFIG_CONF = "trustedvm-fsconfig.conf"
MACHINE_SUPPORTS_USB = "False"
MACHINE_SUPPORTS_ANDROID_PROPERTIES = "False"
MACHINE_SUPPORTS_DISPLAY = "True"
MACHINE_SUPPORTS_SECUREMSM = "True"
MACHINE_SUPPORTS_MINK = "True"
MACHINE_SUPPORTS_TOUCH = "True"
MACHINE_MNT_POINTS = " "
ENABLE_ADB = "False"
# Formats of root filesystem images.
IMAGE_FSTYPES += "ext4"
IMAGE_INIT_MANAGER = "systemd"



VALG = 'False'

SYSTEMIMAGE_TARGET = "system.img"
VMUSERDATAIMAGE_TARGET = "vm-userdata.img"
VMIMAGE_TARGET = "vm-bootsys.img"
VMPERSIST_TARGET = "vm-persist.img"
DTB_TARGET = "vm.dtb"
KERNEL_OFFSET_TRUSTEDVM = "0x200000"
DTB_OFFSET_TRUSTEDVM = "0x2200000"
BASE_DTB_OFFSET_TRUSTEDVM = "0x2600000"
RAMDISK_OFFSET_TRUSTEDVM = "0x2700000"
CMDLINE_OFFSET_TRUSTEDVM = "0x2700000"
VMDATA_OFFSET_TRUSTEDVM = "0x3800000"

KERNEL_OFFSET_OEMVM = "0x200000"
DTB_OFFSET_OEMVM = "0x2200000"
BASE_DTB_OFFSET_OEMVM = "0x2600000"
RAMDISK_OFFSET_OEMVM = "0x2700000"
CMDLINE_OFFSET_OEMVM = "0x2700000"
VMDATA_OFFSET_OEMVM = "0x3800000"

# Ramdisk size is 8 MB
RAMDISK_SIZE = "10388608"

SYSTEM_SIZE_EXT4 ?= "245000000"
USERDATA_SIZE_EXT4 ?= "25000000"
PERSIST_IMAGE_ROOTFS_SIZE = "119000000"
PERSIST_OEMVM_IMAGE_ROOTFS_SIZE = "70000000"
PERSIST_SIZE_EXT4 = "119000000"
VM_PERSIST_SIZE_EXT4 ?= "220000000"
VM_SIZE_EXT4 ?= "562000000"

MACHINE_FEATURES:append = " qti-multivm dm-verity-initramfs qti-vm qti-vm-tui qti-vm-persist qti-smmu-proxy vm-dynamic-memresize qti-vm-target qti-vm-vsock qti-vm-mink qti-avf"


PREFERRED_PROVIDER_virtual/base-utils = "toybox"
VIRTUAL-RUNTIME_base-utils = "toybox"
#VIRTUAL-RUNTIME_base-utils-hwclock = ""
#VIRTUAL-RUNTIME_base-utils-syslog = ""
#VIRTUAL-RUNTIME_login_manager = ""
INIT_MANAGER = "systemd"
TOYBOX_RAMDISK = "True"

# On msm-5.4 or above ufs driver supports BSG Device.
UFS_BSG_DEV_USAGE = "True"

#MACHINE_FEATURES += " gh-loader "

# ZRAM
SWAP_MEMTOTAL_PCT = "200"

DISTRO_FEATURES:append  = " selinux"
DISTRO_FEATURES_FILTER_NATIVE += " selinux "
```
